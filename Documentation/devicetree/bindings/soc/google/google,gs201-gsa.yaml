## drivers/soc/google/cpif/Kconfig
```kconfig
# SPDX-License-Identifier: GPL-2.0-only
#
# Google's modem interface driver (CPIF) for the Samsung S5300 on gs201,
# ported. The symbol names are Google's, because the sources test them.

menuconfig EXYNOS_MODEM_IF
	tristate "Samsung S5300 modem interface (Google's CPIF, bring-up)"
	depends on PCIE_GS201_CP && NET && INET && OF
	help
	  Google's modem interface driver, ported: boots the Samsung S5300
	  modem of Pixel 7 phones over PCIe, then carries its IPC, RFS and
	  packet channels in shared memory as character and network devices
	  (/dev/umts_boot0, /dev/umts_ipc0, /dev/umts_rfs0, rmnet*).

	  For bring-up: the packet processor, DIT, the PCIe IOMMU and S2MPU,
	  BTL, the throughput monitor and the thermal zones are not built.

if EXYNOS_MODEM_IF

config SEC_MODEM_S5100
	bool "S5100-family modem over PCIe (S5300)"
	default y
	select LINK_DEVICE_PCIE
	help
	  The modem control (power, reset, boot, crash dump) for Samsung's
	  S5100 family, which includes the S5300 of gs201 phones.

config LINK_DEVICE_PCIE
	bool

config CPIF_AP_SUSPEND_DURING_VOICE_CALL
	bool
	default y
	help
	  The modem control code stock builds (pantah_defconfig): the AP may
	  suspend while a call's audio runs over the AoC, as notified by the
	  voice call events. Without it the S5100 control code does not build.

config CH_EXTENSION
	bool "Extended packet data channels"
	default y
	help
	  The S5300 firmware of gs201 phones carries packet data on the
	  extended channel range (181 and up, SIPC_CH_EX_ID_PDP_*), which
	  the device tree's rmnet I/O devices use, and the AP advertises
	  that range in its capability word at boot. Without it only
	  channels 10-24 are treated as packet data, and the rmnet
	  interfaces carry nothing. Stock builds it (pantah_defconfig).

	  If unsure, say Y.

config SHM_IPC
	tristate "Shared-memory regions for the modem"
	default EXYNOS_MODEM_IF
	help
	  Maps the modem's reserved-memory regions (IPC, MSI, packet
	  buffers) for the modem interface driver, from a
	  "samsung,exynos-cp-shmem" device tree node.

endif
```

## drivers/soc/google/gnssif_spi/Kconfig
```kconfig
# SPDX-License-Identifier: GPL-2.0-only
config EXYNOS_GNSS_IF_SPI
	tristate "Samsung Kepler GNSS interface over SPI"
	depends on SPI && GPIOLIB && OF
	select WANT_DEV_COREDUMP
	help
	  Google's driver for the Kepler GNSS core in Samsung's S5300 modem,
	  as in the Pixel 9a. gnss_spi binds the core's SPI device, and
	  gnssif binds its two request lines and gives the GNSS daemon the
	  character device /dev/gnss_ipc. The core runs only while the modem
	  is up, with firmware the daemon loads through the modem driver.

	  To compile this driver as modules, choose M here: the modules will
	  be called gnss_spi and gnssif.
```

## drivers/soc/samsung/Kconfig
```kconfig
# SPDX-License-Identifier: GPL-2.0
#
# Samsung SoC drivers
#
menuconfig SOC_SAMSUNG
	bool "Samsung SoC driver support" if COMPILE_TEST

if SOC_SAMSUNG

# There is no need to enable these drivers for ARMv8
config EXYNOS_ASV_ARM
	bool "Exynos ASV ARMv7-specific driver extensions" if COMPILE_TEST
	depends on EXYNOS_CHIPID

config EXYNOS_CHIPID
	tristate "Exynos ChipID controller and ASV driver"
	depends on ARCH_EXYNOS || COMPILE_TEST
	default ARCH_EXYNOS
	select EXYNOS_ASV_ARM if ARM && ARCH_EXYNOS
	select MFD_SYSCON
	select SOC_BUS
	help
	  Support for Samsung Exynos SoC ChipID and Adaptive Supply Voltage.
	  This driver can also be built as module (exynos_chipid).

config EXYNOS_USI
	tristate "Exynos USI (Universal Serial Interface) driver"
	default ARCH_EXYNOS && ARM64
	depends on ARCH_EXYNOS || COMPILE_TEST
	select MFD_SYSCON
	help
	  Enable support for USI block. USI (Universal Serial Interface) is an
	  IP-core found in modern Samsung Exynos SoCs, like Exynos850 and
	  ExynosAutoV9. USI block can be configured to provide one of the
	  following serial protocols: UART, SPI or High Speed I2C.

	  This driver allows one to configure USI for desired protocol, which
	  is usually done in USI node in Device Tree.

config EXYNOS_PMU
	bool "Exynos PMU controller driver" if COMPILE_TEST
	depends on ARCH_EXYNOS || ((ARM || ARM64) && COMPILE_TEST)
	select EXYNOS_PMU_ARM_DRIVERS if ARM && ARCH_EXYNOS
	select MFD_CORE
	select REGMAP_MMIO

# There is no need to enable these drivers for ARMv8
config EXYNOS_PMU_ARM_DRIVERS
	bool "Exynos PMU ARMv7-specific driver extensions" if COMPILE_TEST
	depends on EXYNOS_PMU

config SAMSUNG_PM_CHECK
	bool "S3C2410 PM Suspend Memory CRC"
	depends on PM && (ARCH_S3C64XX || ARCH_S5PV210)
	select CRC32
	help
	  Enable the PM code's memory area checksum over sleep. This option
	  will generate CRCs of all blocks of memory, and store them before
	  going to sleep. The blocks are then checked on resume for any
	  errors.

	  Note, this can take several seconds depending on memory size
	  and CPU speed.

config SAMSUNG_PM_CHECK_CHUNKSIZE
	int "S3C2410 PM Suspend CRC Chunksize (KiB)"
	depends on PM && SAMSUNG_PM_CHECK
	default 64
	help
	  Set the chunksize in Kilobytes of the CRC for checking memory
	  corruption over suspend and resume. A smaller value will mean that
	  the CRC data block will take more memory, but will identify any
	  faults with better precision.

config EXYNOS_REGULATOR_COUPLER
	bool "Exynos SoC Regulator Coupler" if COMPILE_TEST
	depends on ARCH_EXYNOS || COMPILE_TEST

config TEGU_PDMA_PROBE
	tristate "Pixel 9a pdma1 PrimeCell ID probe (bring-up)"
	depends on ARCH_EXYNOS
	default n
	help
	  Bring-up only, not for merge: reads the four PL330 PrimeCell ID
	  registers of the Pixel 9a's pdma1 (0x10130000) once at load and
	  fails the load, so nothing stays resident. For MODEM-PLAN G3.

config TEGU_PDMA_RT
	tristate "Pixel 9a pdma1 runtime registration and memcpy test (bring-up)"
	depends on ARCH_EXYNOS && ARM_AMBA && DMADEVICES
	default n
	help
	  Bring-up only, not for merge: registers the Pixel 9a's pdma1 (PL330
	  at 0x10130000, GIC SPI 806, a fixed 200 MHz APB clock) as an AMBA
	  device at load, so the pl330 driver probes it without a device-tree
	  node, then runs one 256-byte DMA memcpy through it and compares the
	  buffers. For MODEM-PLAN G3.
endif
```

## drivers/thermal/samsung/Kconfig
```kconfig
# SPDX-License-Identifier: GPL-2.0-only
config EXYNOS_THERMAL
	tristate "Exynos thermal management unit driver"
	depends on THERMAL_OF
	depends on HAS_IOMEM
	default ARCH_EXYNOS
	help
	  If you say yes here you get support for the TMU (Thermal Management
	  Unit) driver for Samsung Exynos series of SoCs. This driver initialises
	  the TMU, reports temperature and handles cooling action if defined.
	  This driver uses the Exynos core thermal APIs and TMU configuration
	  data from the supported SoCs.

config GS101_ACPM_THERMAL
	tristate "Google gs101, Tensor G3 and G4 thermal sensors through ACPM"
	depends on THERMAL_OF
	depends on EXYNOS_ACPM_PROTOCOL
	help
	  Thermal zones for the gs101 TMU sensors (CPU clusters, GPU, ISP,
	  TPU), read from the ACPM firmware that owns the TMU. On gs101 the
	  APM owns the TMU registers, so the temperatures come from ACPM's
	  TMU channel. The driver only reads; the firmware's own hardware
	  trips stay as the bootloader left them.

	  Say Y or M here on Google gs101 (Pixel 6) and Tensor G4
	  (zumapro, Pixel 9a) devices.
```
