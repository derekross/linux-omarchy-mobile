## Documentation/devicetree/bindings/soc/google/google,gs201-gsa.yaml
```yaml
# SPDX-License-Identifier: (GPL-2.0-only OR BSD-2-Clause)
%YAML 1.2
---
$id: http://devicetree.org/schemas/soc/google/google,gs201-gsa.yaml#
$schema: http://devicetree.org/meta-schemas/core.yaml#

title: Google gs201 GSA mailbox

maintainers:
  - Derek Ross <derekross@gmail.com>

description:
  The GSA is the security core of Google Tensor SoCs. It authenticates and
  loads the firmware of other cores, such as the AoC audio and sensor DSP.
  The application processor sends it commands through a mailbox of shared
  command and response registers, with one interrupt for responses.

properties:
  compatible:
    const: google,gs201-gsa

  reg:
    minItems: 1
    items:
      - description: mailbox registers
      - description:
          the GSA's stage-2 MPU. Without a hypervisor to program it, the
          driver turns its checks off (CTRL0 only) while the GSA reads an
          image by DMA.

  reg-names:
    minItems: 1
    items:
      - const: mbox
      - const: s2mpu

  interrupts:
    maxItems: 1

required:
  - compatible
  - reg
  - interrupts

additionalProperties: false

examples:
  - |
    #include <dt-bindings/interrupt-controller/arm-gic.h>
    gsa@17c90000 {
        compatible = "google,gs201-gsa";
        reg = <0x17c90000 0x1000>, <0x17c60000 0x10000>;
        reg-names = "mbox", "s2mpu";
        interrupts = <GIC_SPI 363 IRQ_TYPE_LEVEL_HIGH>;
    };
```

## Documentation/devicetree/bindings/sound/awinic,aw882308.yaml
```yaml
# SPDX-License-Identifier: (GPL-2.0-only OR BSD-2-Clause)
%YAML 1.2
---
$id: http://devicetree.org/schemas/sound/awinic,aw882308.yaml#
$schema: http://devicetree.org/meta-schemas/core.yaml#

title: Awinic AW882308 Smart Audio Amplifier

maintainers:
  - Martin Lund <mrlund@hotmail.com>

description:
  The Awinic AW882308 (chip id 0x2308) is an I2C controlled, I2S/TDM
  input mono smart audio amplifier with an integrated boost converter,
  used for the speakers and earpiece of the OnePlus 13.

properties:
  compatible:
    const: awinic,aw882308

  reg:
    maxItems: 1

  '#sound-dai-cells':
    const: 0

  reset-gpios:
    maxItems: 1

  sound-name-prefix: true

required:
  - compatible
  - reg
  - '#sound-dai-cells'

allOf:
  - $ref: dai-common.yaml#

unevaluatedProperties: false

examples:
  - |
    #include <dt-bindings/gpio/gpio.h>

    i2c {
        #address-cells = <1>;
        #size-cells = <0>;

        audio-codec@34 {
            compatible = "awinic,aw882308";
            reg = <0x34>;
            reset-gpios = <&tlmm 2 GPIO_ACTIVE_LOW>;
            #sound-dai-cells = <0>;
            sound-name-prefix = "Left";
        };
    };
```

## Documentation/devicetree/bindings/sound/google,aoc-path.yaml
```yaml
# SPDX-License-Identifier: (GPL-2.0-only OR BSD-2-Clause)
%YAML 1.2
---
$id: http://devicetree.org/schemas/sound/google,aoc-path.yaml#
$schema: http://devicetree.org/meta-schemas/core.yaml#

title: Google Tensor AoC audio path and PCM drivers

maintainers:
  - W4HO <87742609+W4HO-ham@users.noreply.github.com>

description:
  The pieces the AoC sound card (google,aoc-snd-card.yaml) is built from.
  The path is the DAI component every DAI link runs on, one DAI per AoC
  entry point and port. The others are the AoC drivers a DAI link's
  platform names to serve its PCM, by the kind of stream.

properties:
  compatible:
    enum:
      - google-aoc-path
      - google-aoc-snd-pcm
      - google-aoc-snd-voice
      - google-aoc-snd-compr
      - google-aoc-snd-nohost
      - google-aoc-snd-voip
      - google-aoc-snd-incall

  "#sound-dai-cells":
    const: 1

required:
  - compatible

allOf:
  - if:
      properties:
        compatible:
          const: google-aoc-path
    then:
      required:
        - "#sound-dai-cells"
    else:
      properties:
        "#sound-dai-cells": false

additionalProperties: false

examples:
  - |
    aoc_path {
        compatible = "google-aoc-path";
        #sound-dai-cells = <1>;
    };

    aoc_pcm_drv {
        compatible = "google-aoc-snd-pcm";
    };
```

## Documentation/devicetree/bindings/sound/google,aoc-snd-card.yaml
```yaml
# SPDX-License-Identifier: (GPL-2.0-only OR BSD-2-Clause)
%YAML 1.2
---
$id: http://devicetree.org/schemas/sound/google,aoc-snd-card.yaml#
$schema: http://devicetree.org/meta-schemas/core.yaml#

title: Google Tensor AoC sound card

maintainers:
  - W4HO <87742609+W4HO-ham@users.noreply.github.com>

description:
  The sound card of the AoC, the audio and sensor DSP of Tensor SoCs. Its
  front ends are the AoC's entry points (the PCM device number is the entry
  point), and its back ends are the AoC's own ports to the amplifiers,
  microphones, Bluetooth and USB. Each DAI link names the AoC path DAI it
  runs on, the AoC driver that serves its PCM, and for a back end the
  codecs and the format on the wire. The same card serves gs201 and
  zumapro.

properties:
  compatible:
    const: google-aoc-snd-card

  aoc-card-name:
    $ref: /schemas/types.yaml#/definitions/string
    description:
      The ALSA card's long name, which UCM profiles and session rules match.

  codec_cfg:
    type: object
    description: Name prefixes for codecs that serve more than one back end.
    additionalProperties: false
    patternProperties:
      "^[a-z0-9]+$":
        type: object
        additionalProperties: false
        properties:
          of_node:
            $ref: /schemas/types.yaml#/definitions/phandle
            description: The codec.
          prefix:
            $ref: /schemas/types.yaml#/definitions/string
            description: The prefix of its controls and widgets.
        required:
          - of_node
          - prefix

  clks:
    type: object
    description:
      Clocks the AoC drives for codecs or DAIs, from its system clocks (sys)
      or its PLLs (pll).
    additionalProperties: false
    patternProperties:
      "^(sys|pll)$":
        type: object
        additionalProperties: false
        patternProperties:
          "^(sys|pll)@[a-z0-9_]+$":
            type: object
            additionalProperties: false
            properties:
              comp:
                $ref: /schemas/types.yaml#/definitions/phandle
                description: The component the clock feeds.
              dai_id:
                $ref: /schemas/types.yaml#/definitions/uint32
                description: The DAI the clock feeds, when there is no component.
              src:
                enum: [MCLK, BCLK, PLL]
              id:
                $ref: /schemas/types.yaml#/definitions/uint32
              srcid:
                $ref: /schemas/types.yaml#/definitions/uint32
              in_mul:
                $ref: /schemas/types.yaml#/definitions/uint32
              out_mul:
                $ref: /schemas/types.yaml#/definitions/uint32
            oneOf:
              - required: [comp]
              - required: [dai_id]
            required:
              - src
              - id
              - srcid
              - in_mul
              - out_mul

  dai_link:
    type: object
    description: The card's DAI links, front ends (fe_) and back ends (be_).
    additionalProperties: false
    patternProperties:
      "^(fe|be)_[a-z0-9_]+$":
        $ref: "#/$defs/link"

$defs:
  link:
    type: object
    additionalProperties: false
    properties:
      dai-name:
        $ref: /schemas/types.yaml#/definitions/string
      stream-name:
        $ref: /schemas/types.yaml#/definitions/string
      id:
        $ref: /schemas/types.yaml#/definitions/uint32
        description:
          The link's ID. A front end's is its AoC entry point; a back end's
          has bit 31 set and names the AoC port.
      dynamic:
        type: boolean
        description: A DPCM front end.
      no-pcm:
        type: boolean
        description: A DPCM back end, with no PCM device of its own.
      playback:
        type: boolean
      capture:
        type: boolean
      useops:
        type: boolean
        description: The back end uses the AoC path's stream operations.
      usefixup:
        type: boolean
        description: The back end's hardware parameters come from its AoC port.
      cpu:
        type: object
        additionalProperties: false
        properties:
          sound-dai:
            $ref: /schemas/types.yaml#/definitions/phandle-array
            maxItems: 1
            description: The AoC path DAI and the link's ID.
        required:
          - sound-dai
      codec:
        type: object
        additionalProperties: false
        properties:
          sound-dai:
            $ref: /schemas/types.yaml#/definitions/phandle-array
            minItems: 1
        required:
          - sound-dai
      platform:
        type: object
        additionalProperties: false
        description: The AoC drivers that serve the link's PCM.
        patternProperties:
          "^(rx|tx|vorx|votx)[0-9]*$":
            type: object
            additionalProperties: false
            properties:
              of_drv:
                $ref: /schemas/types.yaml#/definitions/phandle
            required:
              - of_drv
      daifmt:
        type: object
        additionalProperties: false
        properties:
          dai-format:
            enum: [i2s, dsp_a, dsp_b, left_j, right_j]
          bitclock-inversion:
            type: boolean
        required:
          - dai-format
    required:
      - dai-name
      - stream-name
      - id
      - cpu

required:
  - compatible
  - aoc-card-name
  - dai_link

additionalProperties: false

examples:
  - |
    sound-aoc {
        compatible = "google-aoc-snd-card";
        aoc-card-name = "google,tegu-aoc-snd-card";

        codec_cfg {
            top {
                of_node = <1>;
                prefix = "Top";
            };
        };

        dai_link {
            fe_ep1_rx {
                dai-name = "audio_playback0";
                stream-name = "EP1 playback";
                id = <0x00>;
                dynamic;
                playback;

                cpu {
                    sound-dai = <2 0x00>;
                };

                platform {
                    rx1 {
                        of_drv = <3>;
                    };
                };
            };

            be_tdm0_rx {
                dai-name = "TDM_0_RX Playback";
                stream-name = "TDM_0_RX Playback";
                id = <0x80000006>;
                playback;
                no-pcm;
                useops;
                usefixup;

                codec {
                    sound-dai = <1>;
                };

                cpu {
                    sound-dai = <2 0x80000006>;
                };

                daifmt {
                    dai-format = "dsp_a";
                };
            };
        };
    };
```

## drivers/misc/bcm4775x/Kconfig
```kconfig
# SPDX-License-Identifier: GPL-2.0
config BCM4775X_GNSS
	tristate "Broadcom BCM4775x GNSS receiver on SPI (lhd interface)"
	depends on SPI && GPIOLIB && REGULATOR
	help
	  The Broadcom BCM4775x GNSS receiver on SPI, as used in Google's
	  Pixel 7 phones. It exposes the chip's SSI link as /dev/ttyBCM and
	  the /dev/bbd_* nodes for Broadcom's own location daemons (lhd,
	  gpsd), which load the chip's patch and produce the positions.

	  To compile this driver as a module, choose M here: the module
	  will be called bcm4775x-gnss.
```

## drivers/soc/google/Kconfig
```kconfig
# SPDX-License-Identifier: GPL-2.0-only

if ARCH_EXYNOS || COMPILE_TEST

menu "Google SoC drivers"

config GOOGLE_GSA
	tristate "Google GSA mailbox"
	depends on DEBUG_FS
	help
	  The GSA is the security core of Google Tensor SoCs. It authenticates
	  and loads the firmware of other cores, such as the AoC (the audio
	  and sensor DSP), and is reached through a mailbox of command and
	  response registers.

	  This driver gives the AoC driver the GSA's firmware loading and
	  exposes status queries in debugfs, for bring-up.

config GOOGLE_GSA_TRUSTY
	bool "AoC state commands through Trusty"
	depends on GOOGLE_GSA && TRUSTY_VIRTIO_IPC
	depends on TRUSTY_VIRTIO_IPC=y || GOOGLE_GSA=m
	help
	  Send AoC state commands (start, reset, get state) to the GSA's
	  hwmgr.aoc service in Trusty, as Google's kernels do. Without it,
	  only the mailbox command can be tried (aoc_cmd_mbox=1), which no
	  Google kernel uses.

config GS201_AOC_SYSMMU
	tristate "gs201 AoC System MMU static windows"
	help
	  Programs the AoC's System MMU with the fixed windows its firmware
	  expects (from the firmware image header), as 1 MiB sections. Used by
	  the AoC driver.

config GS201_AOC_BOOT
	tristate "gs201 AoC firmware boot (bring-up)"
	depends on GOOGLE_GSA && GS201_AOC_SYSMMU && DEBUG_FS
	help
	  Boots the AoC firmware step by step from debugfs: power request,
	  System MMU windows, GSA authentication, start. It does not run the
	  AoC's services; it only checks that the firmware comes up. For
	  bring-up only.

config GS201_AOC_RAILS
	tristate "gs201 AoC microphone and sensor supplies over ACPM (bring-up)"
	depends on EXYNOS_ACPM_PROTOCOL
	help
	  Reads, and with enable=1 turns on, the five S2MPG12/S2MPG13 LDOs that
	  feed the AoC's digital microphones and sensors, until there is an
	  S2MPG12/13 regulator driver. For bring-up only.

config GS201_CAM_POWER
	tristate "gs201 camera module power sequencing and ID reads (bring-up)"
	depends on I2C && DEBUG_FS && OF
	help
	  Binds to a camera module's I2C device and, from debugfs, powers it
	  up and down in the order and with the delays the device tree
	  gives, and reads single identification registers from a list in
	  the device tree. It never writes to the device. For bring-up only,
	  until there are sensor drivers.

config GS201_AOC_MBOX
	tristate "gs201 AoC mailboxes"
	depends on MAILBOX
	help
	  The doorbell and shared-register mailboxes between the AP and the
	  AoC (Google's whitechapel mailbox driver).

config GS201_AOC
	tristate "gs201 AoC core (Google's driver)"
	depends on GOOGLE_GSA && GS201_AOC_SYSMMU && GS201_AOC_MBOX
	help
	  Google's AoC core driver, ported: loads and authenticates the AoC
	  firmware through the GSA, starts it, and exposes its services on the
	  AoC bus. Firmware loading is triggered from sysfs (firmware), not at
	  probe.

config GS201_AOC_CHAR
	tristate "gs201 AoC service character devices"
	depends on GS201_AOC
	help
	  /dev/acd-<service> character devices for AoC services
	  (aoc_char_dev), and channelized ones for services such as the
	  sensor framework (aoc_channel_dev).

config GS201_AOC_ALSA
	tristate "gs201 AoC sound card (Google's driver)"
	depends on GS201_AOC && SND_SOC
	select SND_COMPRESS_OFFLOAD
	help
	  Google's AoC ALSA/ASoC driver, ported: the AoC's playback and
	  capture endpoints, its audio routing controls, and a sound card with
	  the speaker amplifiers on TDM 0. The card enforces the speaker
	  limits in device/cheetah/AUDIO-PLAN.md.

source "drivers/soc/google/cpif/Kconfig"

endmenu

endif
```
