## Documentation/devicetree/bindings/media/i2c/samsung,s5kgn1.yaml
```yaml
# SPDX-License-Identifier: GPL-2.0-only OR BSD-2-Clause
%YAML 1.2
---
$id: http://devicetree.org/schemas/media/i2c/samsung,s5kgn1.yaml#
$schema: http://devicetree.org/meta-schemas/core.yaml#

title: Samsung S5KGN1, S5K3J1 and S5KGM5 image sensors

maintainers:
  - Derek Ross <derekross@gmail.com>

description:
  Samsung Bayer CMOS sensors with a MIPI CSI-2 C-PHY or D-PHY output,
  controlled over I2C - the S5KGN1 (ISOCELL GN1, 50 MP, dual-pixel phase
  detection), the S5K3J1 (10.5 MP, dual-pixel phase detection) and the
  S5KGM5 (ISOCELL GM5, 48 MP), and the S5KGN8 (model 0x08e8, the Pixel 9a
  main camera). Their initialisation and readout modes are
  loaded from a data file named by firmware-name.

allOf:
  - $ref: /schemas/media/video-interface-devices.yaml#
  - if:
      properties:
        compatible:
          enum:
            - samsung,s5kgn1
            - samsung,s5kgn8
    then:
      required:
        - vaux-supply
        - vana-supply
    else:
      properties:
        vaux-supply: false
  - if:
      properties:
        compatible:
          const: samsung,s5kgn8
    then:
      required:
        - vaux2-supply
        - vdig-supply
      properties:
        vsw-supply: false
    else:
      properties:
        vaux2-supply: false
  - if:
      properties:
        compatible:
          const: samsung,s5kgm5
    then:
      required:
        - vana-supply
      properties:
        vsw-supply: false
  - if:
      properties:
        compatible:
          const: samsung,s5k3j1
    then:
      properties:
        vana-supply: false

properties:
  compatible:
    enum:
      - samsung,s5k3j1
      - samsung,s5kgm5
      - samsung,s5kgn1
      - samsung,s5kgn8

  reg:
    maxItems: 1

  clocks:
    maxItems: 1

  reset-gpios:
    maxItems: 1
    description: RSTN, active low.

  vio-supply:
    description: Interface (1.8 V) supply.

  vaux-supply:
    description:
      The module's auxiliary supply (2.9 V on the Pixel 7 Pro, shared with
      its focus actuator), switched on right after the interface supply.

  vaux2-supply:
    description:
      A second auxiliary supply (2.9 V on the Pixel 9a, shared with the
      module's focus actuator and EEPROM), switched on after vaux-supply.

  vsw-supply:
    description:
      A switched module supply, on before the core supplies (S5KGN1) or
      after the digital supply (S5K3J1).

  vdig-supply:
    description: Digital core supply.

  vana-supply:
    description: Analog supply.

  vbb-supply:
    description:
      Board supply feeding the module's analog regulators, to be switched on
      first where the board's power-up order requires it.

  vbuck-supply:
    description:
      Board supply feeding the module's digital regulator, switched on
      after vbb-supply.

  firmware-name:
    maxItems: 1

  samsung,power-delays-us:
    description:
      Overrides the part's power-up waits. The S5KGN1 releases reset before
      starting its clock, the others after.
    items:
      - description: wait after vaux-supply (S5KGN1) or vio-supply (S5KGM5)
      - description: wait after the last supply
      - description: wait after the first of reset and clock
      - description: wait after the other

  samsung,vertical-flip:
    type: boolean
    description:
      Read the pixel array out bottom to top. For a module whose optics
      mirror the image vertically, such as a folded telephoto lens.

  samsung,max-line-throughput:
    $ref: /schemas/types.yaml#/definitions/uint32
    description:
      The most bytes per microsecond (MB/s) the receiver takes within a
      line. Modes whose lines would arrive faster get a longer line length
      (more horizontal blanking at the same pixel clock).

  port:
    $ref: /schemas/graph.yaml#/$defs/port-base
    unevaluatedProperties: false

    properties:
      endpoint:
        $ref: /schemas/media/video-interfaces.yaml#
        unevaluatedProperties: false

        properties:
          bus-type:
            enum:
              - 1 # MEDIA_BUS_TYPE_CSI2_CPHY
              - 4 # MEDIA_BUS_TYPE_CSI2_DPHY
          data-lanes:
            minItems: 1
            maxItems: 4
          link-frequencies: true

        required:
          - data-lanes
          - link-frequencies

required:
  - compatible
  - reg
  - clocks
  - reset-gpios
  - vio-supply
  - vdig-supply
  - firmware-name
  - port

unevaluatedProperties: false

examples:
  - |
    #include <dt-bindings/gpio/gpio.h>
    #include <dt-bindings/media/video-interfaces.h>
    i2c {
        #address-cells = <1>;
        #size-cells = <0>;

        camera@3d {
            compatible = "samsung,s5kgn1";
            reg = <0x3d>;
            clocks = <&mclk>;
            reset-gpios = <&gpp2 2 GPIO_ACTIVE_LOW>;
            vio-supply = <&vddio_cam>;
            vaux-supply = <&main_vaux>;
            vsw-supply = <&main_sw>;
            vdig-supply = <&main_dvdd>;
            vana-supply = <&main_avdd>;
            firmware-name = "omamobile/camera/s5kgn1-main.bin";
            lens-focus = <&main_vcm>;
            orientation = <1>;
            rotation = <90>;

            port {
                endpoint {
                    remote-endpoint = <&csis_in>;
                    bus-type = <MEDIA_BUS_TYPE_CSI2_CPHY>;
                    data-lanes = <1 2 3>;
                    link-frequencies = /bits/ 64 <931229968>;
                };
            };
        };
    };

  - |
    #include <dt-bindings/gpio/gpio.h>
    #include <dt-bindings/media/video-interfaces.h>
    i2c {
        #address-cells = <1>;
        #size-cells = <0>;

        camera@2d {
            compatible = "samsung,s5kgm5";
            reg = <0x2d>;
            clocks = <&mclk>;
            reset-gpios = <&gpp6 2 GPIO_ACTIVE_LOW>;
            vio-supply = <&vddio_cam>;
            vdig-supply = <&tele_dvdd>;
            vana-supply = <&tele_avdd>;
            firmware-name = "omamobile/camera/s5kgm5-tele.bin";
            samsung,vertical-flip;
            orientation = <1>;
            rotation = <270>;

            port {
                endpoint {
                    remote-endpoint = <&csis_in>;
                    bus-type = <MEDIA_BUS_TYPE_CSI2_CPHY>;
                    data-lanes = <1 2>;
                    link-frequencies = /bits/ 64 <901120000>;
                };
            };
        };
    };
```

## Documentation/devicetree/bindings/media/i2c/sony,imx386.yaml
```yaml
# SPDX-License-Identifier: GPL-2.0-only OR BSD-2-Clause
%YAML 1.2
---
$id: http://devicetree.org/schemas/media/i2c/sony,imx386.yaml#
$schema: http://devicetree.org/meta-schemas/core.yaml#

title: Sony IMX386 and IMX712 image sensors

maintainers:
  - Derek Ross <derekross@gmail.com>

description:
  Sony IMX386 12 MP Bayer CMOS sensor with a MIPI CSI-2 D-PHY output,
  controlled over I2C, and the IMX712 (the Pixel 9a's ultrawide and front
  cameras), which has the same register map. Their initialisation and
  readout modes are loaded from a data file named by firmware-name.

allOf:
  - $ref: /schemas/media/video-interface-devices.yaml#

properties:
  compatible:
    enum:
      - sony,imx386
      - sony,imx712

  reg:
    maxItems: 1

  clocks:
    maxItems: 1

  reset-gpios:
    maxItems: 1
    description: XCLR, active low.

  vif-supply:
    description: Interface (1.8 V) supply.

  vdig-supply:
    description: Digital core supply.

  vana-supply:
    description: Analog supply.

  vbb-supply:
    description:
      Board supply feeding the module's analog regulator, to be switched on
      first where the board's power-up order requires it.

  vbuck-supply:
    description:
      Board supply feeding the module's digital regulator, switched on
      after vbb-supply.

  firmware-name:
    maxItems: 1

  sony,power-delays-us:
    items:
      - description: wait after the last supply
      - description: wait after the clock starts
      - description: wait after reset is released

  sony,max-line-throughput:
    $ref: /schemas/types.yaml#/definitions/uint32
    description:
      The most bytes per microsecond (MB/s) the receiver takes within a
      line. Modes whose lines would arrive faster get a longer line length
      (more horizontal blanking at the same pixel clock).

  port:
    $ref: /schemas/graph.yaml#/$defs/port-base
    unevaluatedProperties: false
    description:
      Output port. A board whose sensor can reach more than one receiver has
      one endpoint per receiver; only the enabled receiver uses it.

    patternProperties:
      "^endpoint(@[0-9a-f]+)?$":
        $ref: /schemas/media/video-interfaces.yaml#
        unevaluatedProperties: false

        properties:
          data-lanes:
            minItems: 2
            maxItems: 4
          link-frequencies: true

        required:
          - data-lanes
          - link-frequencies

required:
  - compatible
  - reg
  - clocks
  - reset-gpios
  - vif-supply
  - vdig-supply
  - vana-supply
  - firmware-name
  - port

unevaluatedProperties: false

examples:
  - |
    #include <dt-bindings/gpio/gpio.h>
    i2c {
        #address-cells = <1>;
        #size-cells = <0>;

        camera@1a {
            compatible = "sony,imx386";
            reg = <0x1a>;
            clocks = <&mclk>;
            reset-gpios = <&gpp6 3 GPIO_ACTIVE_LOW>;
            vif-supply = <&vddio_cam>;
            vdig-supply = <&uw_dvdd>;
            vana-supply = <&uw_avdd>;
            firmware-name = "omamobile/camera/imx386-uw.bin";
            orientation = <1>;
            rotation = <90>;

            port {
                sensor_out: endpoint {
                    remote-endpoint = <&csis_in>;
                    data-lanes = <1 2 3 4>;
                    link-frequencies = /bits/ 64 <600000000>;
                };
            };
        };
    };
```

## Documentation/devicetree/bindings/mfd/samsung,s2mpg14-pmic.yaml
```yaml
# SPDX-License-Identifier: GPL-2.0-only OR BSD-2-Clause
%YAML 1.2
---
$id: http://devicetree.org/schemas/mfd/samsung,s2mpg14-pmic.yaml#
$schema: http://devicetree.org/meta-schemas/core.yaml#

title: Samsung S2MPG14 Power Management IC

maintainers:
  - W4HO <87742609+W4HO-ham@users.noreply.github.com>

description: |
  S2MPG14 is the main PMIC paired with Google's Tensor G3 and Tensor G4.
  Its LDO4M and LDO25M outputs supply the analog and digital touchscreen
  power rails.

properties:
  compatible:
    const: samsung,s2mpg14-pmic

  gpio:
    type: object
    description:
      The PMIC's six general purpose pins. On the Pixel 9a one switches
      the main camera's digital supply.

    properties:
      compatible:
        const: samsung,s2mpg14-gpio

      gpio-controller: true

      '#gpio-cells':
        const: 2

      gpio-line-names:
        maxItems: 6

    required:
      - compatible
      - gpio-controller
      - '#gpio-cells'

    additionalProperties: false

  regulators:
    type: object
    $ref: /schemas/regulator/samsung,s2mpg14-regulator.yaml

required:
  - compatible
  - regulators

additionalProperties: false

examples:
  - |
    pmic-1 {
        compatible = "samsung,s2mpg14-pmic";

        gpio {
            compatible = "samsung,s2mpg14-gpio";
            gpio-controller;
            #gpio-cells = <2>;
        };

        regulators {
            ldo4m {
                regulator-name = "touch-avdd";
            };

            ldo25m {
                regulator-name = "touch-vdd";
            };
        };
    };
```

## Documentation/devicetree/bindings/mfd/samsung,s2mpg15-pmic.yaml
```yaml
# SPDX-License-Identifier: GPL-2.0-only OR BSD-2-Clause
%YAML 1.2
---
$id: http://devicetree.org/schemas/mfd/samsung,s2mpg15-pmic.yaml#
$schema: http://devicetree.org/meta-schemas/core.yaml#

title: Samsung S2MPG15 Power Management IC

maintainers:
  - W4HO <87742609+W4HO-ham@users.noreply.github.com>

description: |
  S2MPG15 is the sub PMIC paired with Google's Tensor G4 and is reached
  through ACPM. Its LDOs supply the AoC sensors, the camera sensors and
  the fingerprint sensor.
  Interrupt, meter and RTC functions are not described here.

properties:
  compatible:
    const: samsung,s2mpg15-pmic

  gpio:
    type: object
    description:
      The PMIC's ten general purpose pins. On the Pixel 9a they enable
      the camera buck-boost, the camera PMIC and the cameras' 1.35 V
      supply.

    properties:
      compatible:
        const: samsung,s2mpg15-gpio

      gpio-controller: true

      '#gpio-cells':
        const: 2

      gpio-line-names:
        maxItems: 10

    required:
      - compatible
      - gpio-controller
      - '#gpio-cells'

    additionalProperties: false

  regulators:
    type: object
    $ref: /schemas/regulator/samsung,s2mpg15-regulator.yaml

required:
  - compatible
  - regulators

additionalProperties: false

examples:
  - |
    pmic-2 {
        compatible = "samsung,s2mpg15-pmic";

        gpio {
            compatible = "samsung,s2mpg15-gpio";
            gpio-controller;
            #gpio-cells = <2>;
        };

        regulators {
            ldo5s {
                regulator-name = "sensor-3v3";
            };

            ldo7s {
                regulator-name = "sensor-1v8";
            };
        };
    };
```

## Documentation/devicetree/bindings/misc/goodix,g7-udfps.yaml
```yaml
# SPDX-License-Identifier: (GPL-2.0-only OR BSD-2-Clause)
%YAML 1.2
---
$id: http://devicetree.org/schemas/misc/goodix,g7-udfps.yaml#
$schema: http://devicetree.org/meta-schemas/core.yaml#

title: Goodix optical under-display fingerprint sensor (secure world bus)

maintainers:
  - Derek Ross <derekross@gmail.com>

description:
  Goodix optical fingerprint sensor under an OLED panel, as in the Google
  Pixel 7 Pro. Its SPI bus is owned by a trusted application in the secure
  world, so the node is not on an SPI controller; it describes only the
  lines the application processor drives.

properties:
  compatible:
    const: goodix,g7-udfps

  interrupts:
    maxItems: 1
    description: Sensor event line (rising edge).

  reset-gpios:
    maxItems: 1

  vdd-supply:
    description: Sensor analog supply.

required:
  - compatible
  - interrupts
  - reset-gpios

additionalProperties: false

examples:
  - |
    #include <dt-bindings/gpio/gpio.h>
    #include <dt-bindings/interrupt-controller/irq.h>

    fingerprint {
        compatible = "goodix,g7-udfps";
        interrupt-parent = <&gpa9>;
        interrupts = <2 IRQ_TYPE_EDGE_RISING>;
        reset-gpios = <&gpp1 1 GPIO_ACTIVE_LOW>;
    };
```
