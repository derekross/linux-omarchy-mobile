## Documentation/devicetree/bindings/leds/ti,lm3644.yaml
```yaml
# SPDX-License-Identifier: (GPL-2.0-only OR BSD-2-Clause)
%YAML 1.2
---
$id: http://devicetree.org/schemas/leds/ti,lm3644.yaml#
$schema: http://devicetree.org/meta-schemas/core.yaml#

title: Texas Instruments LM3644 dual-channel flash LED driver

maintainers:
  - Derek Ross <derekross@gmail.com>

description: |
  The LM3644 and LM3644TT are I2C-controlled flash LED drivers with a
  boost converter and two current sinks (LED1, LED2), each capable of up to
  1.5 A in flash mode and of a lower continuous torch current. The chip is
  held in shutdown while its HWEN pin is low. The variants differ in torch
  current resolution and are told apart by the device ID register.

properties:
  compatible:
    const: ti,lm3644

  reg:
    maxItems: 1

  enable-gpios:
    maxItems: 1
    description: GPIO connected to the HWEN pin.

  strobe-gpios:
    maxItems: 1
    description: |
      GPIO connected to the active-high STROBE pin. When supplied, the
      torch-only driver holds it low to prevent external flash triggering.

  led:
    type: object
    $ref: common.yaml#
    unevaluatedProperties: false

    properties:
      led-sources:
        minItems: 1
        maxItems: 2
        items:
          enum: [1, 2]
        description: Current sinks driving this LED, LED1 = 1, LED2 = 2.

      led-max-microamp:
        description: Torch current limit per current sink.
        minimum: 977
        maximum: 372000

    required:
      - led-sources
      - led-max-microamp

required:
  - compatible
  - reg
  - enable-gpios
  - led

additionalProperties: false

examples:
  - |
    #include <dt-bindings/gpio/gpio.h>
    #include <dt-bindings/leds/common.h>

    i2c {
      #address-cells = <1>;
      #size-cells = <0>;

      led-controller@63 {
        compatible = "ti,lm3644";
        reg = <0x63>;
        enable-gpios = <&gpio 2 GPIO_ACTIVE_HIGH>;

        led {
          function = LED_FUNCTION_TORCH;
          color = <LED_COLOR_ID_WHITE>;
          led-sources = <1 2>;
          led-max-microamp = <50000>;
        };
      };
    };
```

## Documentation/devicetree/bindings/mailbox/google,gs201-aoc-mbox.yaml
```yaml
# SPDX-License-Identifier: (GPL-2.0-only OR BSD-2-Clause)
%YAML 1.2
---
$id: http://devicetree.org/schemas/mailbox/google,gs201-aoc-mbox.yaml#
$schema: http://devicetree.org/meta-schemas/core.yaml#

title: Google gs201 AoC mailbox

maintainers:
  - Derek Ross <derekross@gmail.com>

description:
  One of the three mailboxes between the application processor and the
  AoC (audio and sensor DSP) of gs201. Each has 16 doorbell channels in
  each direction and eight shared registers; the AoC's interrupts to the
  AP arrive on one line.

properties:
  compatible:
    const: google,gs201-aoc-mbox

  reg:
    maxItems: 1

  interrupts:
    maxItems: 1

  "#mbox-cells":
    const: 1

required:
  - compatible
  - reg
  - interrupts
  - "#mbox-cells"

additionalProperties: false

examples:
  - |
    #include <dt-bindings/interrupt-controller/arm-gic.h>
    mailbox@18300000 {
        compatible = "google,gs201-aoc-mbox";
        reg = <0x18300000 0x1000>;
        interrupts = <GIC_SPI 75 IRQ_TYPE_LEVEL_HIGH>;
        #mbox-cells = <1>;
    };
```

## Documentation/devicetree/bindings/media/google,gs201-csis.yaml
```yaml
# SPDX-License-Identifier: GPL-2.0-only OR BSD-2-Clause
%YAML 1.2
---
$id: http://devicetree.org/schemas/media/google,gs201-csis.yaml#
$schema: http://devicetree.org/meta-schemas/core.yaml#

title: Google gs201 and zumapro CSIS camera receiver link and CSIS WDMA

maintainers:
  - Derek Ross <derekross@gmail.com>

description:
  The camera block of Google's gs201 SoC has eight MIPI CSI-2 receiver links
  (CSIS) and a DMA block whose CSIS WDMA contexts write a link's frames to
  memory. One node describes one link and the WDMA context it feeds.
  zumapro (Tensor G4) has the same receiver link in its ISP front end, with
  twelve link contexts; its DMA path is different and not described here.

properties:
  compatible:
    enum:
      - google,gs201-csis
      - google,zumapro-csis

  reg:
    minItems: 1
    maxItems: 4

  reg-names:
    minItems: 1
    maxItems: 4

  interrupts:
    minItems: 1
    maxItems: 2

  interrupt-names:
    minItems: 1
    maxItems: 2

  clocks:
    maxItems: 2

  clock-names:
    maxItems: 2

  phys:
    maxItems: 1
    description: The link's DC-PHY receiver.

  google,csis-link:
    $ref: /schemas/types.yaml#/definitions/uint32
    maximum: 11
    description: Index of the CSIS link (0-7 on gs201).

  google,wdma-context:
    $ref: /schemas/types.yaml#/definitions/uint32
    maximum: 3
    description: Index of the CSIS WDMA context.

  google,csis-sysreg:
    $ref: /schemas/types.yaml#/definitions/phandle
    description:
      The camera block's system registers, which route a link through an
      EBUF to a WDMA context.

  google,ebuf:
    $ref: /schemas/types.yaml#/definitions/uint32
    maximum: 3
    description:
      WDMA input slot the link is routed to; defaults to the context index.

  google,image-loch:
    $ref: /schemas/types.yaml#/definitions/uint32
    maximum: 6
    description:
      zumapro only. The CSIS core's image logical channel the link writes
      its frames through; defaults to 0.

  google,lrte-packet-delimiters:
    type: boolean
    description:
      The sensor ends its C-PHY packets with LRTE packet delimiters (EPD),
      which the link must be told to expect; without it, such a link
      decodes frame starts and nothing else.

  memory-region:
    maxItems: 1
    description: Pool for capture buffers the WDMA can address.

  power-domains:
    maxItems: 1

  iommus:
    maxItems: 1

  port:
    $ref: /schemas/graph.yaml#/$defs/port-base
    unevaluatedProperties: false
    description: Input port, connected to the sensor.

    properties:
      endpoint:
        $ref: video-interfaces.yaml#
        unevaluatedProperties: false

        properties:
          bus-type:
            enum:
              - 1 # MEDIA_BUS_TYPE_CSI2_CPHY
              - 4 # MEDIA_BUS_TYPE_CSI2_DPHY
            description:
              D-PHY when absent. C-PHY counts trios in data-lanes (up to
              three on links 0 and 1, two on the others).
          data-lanes:
            minItems: 1
            maxItems: 4

        required:
          - data-lanes

required:
  - compatible
  - reg
  - reg-names
  - interrupts
  - interrupt-names
  - phys
  - google,csis-link
  - port

allOf:
  - if:
      properties:
        compatible:
          const: google,gs201-csis
    then:
      properties:
        reg:
          minItems: 3
          items:
            - description: the CSIS link registers
            - description: the CSIS DMA block's common page (shared by all links)
            - description: the CSIS WDMA context (links may share one; they
                then stream one at a time)
            - description: the EBUF control (shared by all links), bypassed on
                the way to the WDMA
        reg-names:
          minItems: 3
          items:
            - const: link
            - const: dma
            - const: wdma
            - const: ebuf
        interrupts:
          items:
            - description: link interrupt
            - description: WDMA context interrupt
        interrupt-names:
          items:
            - const: link
            - const: wdma
        clocks:
          items:
            - description: the camera block's DVFS domain
            - description: the bus (INT) DVFS domain
        clock-names:
          items:
            - const: cam
            - const: int
        google,csis-link:
          maximum: 7
        google,image-loch: false
      required:
        - google,wdma-context
        - google,csis-sysreg
    else:
      properties:
        reg:
          minItems: 1
          items:
            - description: the CSIS link registers
            - description: the ISP front end's CSIS core page, shared by all
                links; without it the link runs without DMA
        reg-names:
          minItems: 1
          items:
            - const: link
            - const: core
        interrupts:
          minItems: 1
          items:
            - description: link interrupt
            - description: CSIS core interrupt, shared by all links
        interrupt-names:
          minItems: 1
          items:
            - const: link
            - const: core
        clocks:
          items:
            - description: the INT DVFS domain, the ISP front end clock's rail
            - description: the ISP front end's NOC clock
        clock-names:
          items:
            - const: int
            - const: fe
        google,wdma-context: false
        google,csis-sysreg: false
        google,ebuf: false

additionalProperties: false

examples:
  - |
    #include <dt-bindings/interrupt-controller/arm-gic.h>
    csis@1a440000 {
        compatible = "google,gs201-csis";
        reg = <0x1a440000 0x1000>, <0x1a4d0000 0x1000>, <0x1a4d7000 0x1000>;
        reg-names = "link", "dma", "wdma";
        interrupts = <GIC_SPI 189 IRQ_TYPE_LEVEL_HIGH>,
                     <GIC_SPI 197 IRQ_TYPE_LEVEL_HIGH>;
        interrupt-names = "link", "wdma";
        phys = <&csis_dcphy 0>;
        google,csis-link = <0>;
        google,wdma-context = <0>;
        google,csis-sysreg = <&sysreg_csis>;

        port {
            csis_in: endpoint {
                remote-endpoint = <&sensor_out>;
                data-lanes = <1 2 3 4>;
            };
        };
    };
```

## Documentation/devicetree/bindings/media/i2c/onnn,lc898129.yaml
```yaml
# SPDX-License-Identifier: GPL-2.0-only OR BSD-2-Clause
%YAML 1.2
---
$id: http://devicetree.org/schemas/media/i2c/onnn,lc898129.yaml#
$schema: http://devicetree.org/meta-schemas/core.yaml#

title: onsemi LC898129 camera lens autofocus and stabilisation controller

maintainers:
  - cbm <omarchy-mobile@kloot.lu>

description:
  The onsemi LC898129 is a microcontroller that drives a camera module's
  focus and optical image stabilisation actuators and holds the module's
  calibration memory, controlled over I2C with 16-bit register addresses
  and 32-bit values. It shares the module's supplies and reset with the
  image sensor, which powers it while streaming (the sensor's lens-focus
  property). It is the controller of the Google Pixel 9a's main camera
  module.

properties:
  compatible:
    const: onnn,lc898129

  reg:
    maxItems: 1

  vio-supply:
    description: Interface (1.8 V) supply.

  vm-supply:
    description: Actuator driver supply (VM).

  vdda-supply:
    description: Actuator driver analogue supply (VDDA).

required:
  - compatible
  - reg

additionalProperties: false

examples:
  - |
    i2c {
        #address-cells = <1>;
        #size-cells = <0>;

        lens@24 {
            compatible = "onnn,lc898129";
            reg = <0x24>;
            vio-supply = <&vddio_cam>;
        };
    };
```
