## Documentation/devicetree/bindings/pci/google,zumapro-pcie.yaml
```yaml
# SPDX-License-Identifier: (GPL-2.0-only OR BSD-2-Clause)
%YAML 1.2
---
$id: http://devicetree.org/schemas/pci/google,zumapro-pcie.yaml#
$schema: http://devicetree.org/meta-schemas/core.yaml#

title: Google zumapro (Tensor G4) PCIe host controller

maintainers:
  - W4HO <87742609+W4HO-ham@users.noreply.github.com>

description:
  The second PCIe channel (channel 1) of the Google zumapro (Tensor G4) SoC,
  one lane in the HSI2 block, is a Synopsys DesignWare core in a Samsung
  wrapper. The wrapper adds an external local bus interface (ELBI) with link
  training control and status, a sub-system control block, the PHY's debug
  (UDBG), PMA and PCS register blocks, and an I/A sequencer. The PHY sits
  behind an isolation switch in the PMU, which has to be opened before any
  of these registers is accessed. MSIs are received by the
  DesignWare core's own MSI controller and signalled on five interrupt
  lines, one per group of 32 vectors.

allOf:
  - $ref: /schemas/pci/pci-host-bridge.yaml#

properties:
  compatible:
    const: google,zumapro-pcie

  reg:
    items:
      - description: External local bus interface (ELBI) registers
      - description: Sub-system control registers
      - description: PHY debug (UDBG) registers
      - description: PHY PMA registers
      - description: PHY PCS registers
      - description: I/A sequencer registers
      - description: Data Bus Interface (DBI) registers, with the unrolled
          iATU at offset 0x300000
      - description: PCIe configuration space region

  reg-names:
    items:
      - const: elbi
      - const: soc
      - const: udbg
      - const: phy
      - const: pcs
      - const: ia
      - const: dbi
      - const: config

  interrupts:
    items:
      - description: Controller interrupt
      - description: MSI vectors 0 to 31
      - description: MSI vectors 32 to 63
      - description: MSI vectors 64 to 95
      - description: MSI vectors 96 to 127
      - description: MSI vectors 128 to 159

  interrupt-names:
    items:
      - const: ctrl
      - const: msi0
      - const: msi1
      - const: msi2
      - const: msi3
      - const: msi4

  clocks:
    items:
      - description: Controller APB clock
      - description: DBI AXI clock
      - description: AXI slave clock
      - description: AXI master clock
      - description: PHY UDBG APB clock
      - description: PHY PAL APB clock
      - description: PHY reference clock
      - description: PHY bridge APB clock
      - description: PHY test APB clock
      - description: I/A sequencer clock
      - description: I/A SSMT AXI clock
      - description: I/A SSMT APB clock
      - description: System MMU clock
      - description: PMMU clock

  clock-names:
    items:
      - const: ctl-apb
      - const: dbi-aclk
      - const: slv-aclk
      - const: mstr-aclk
      - const: phy-udbg-apb
      - const: phy-pal-apb
      - const: phy-ref
      - const: phy-bridge-apb
      - const: phy-test-apb
      - const: ia-clk
      - const: ssmt-ia-aclk
      - const: ssmt-ia-pclk
      - const: sysmmu-clk
      - const: pmmu-clk

  reset-gpios:
    description: PERST# of the endpoint.
    maxItems: 1

  samsung,pmu-syscon:
    $ref: /schemas/types.yaml#/definitions/phandle-array
    items:
      - items:
          - description: phandle of the PMU system controller
          - description: offset of the PCIe PHY control register
    description:
      The PMU register that isolates the PCIe PHY. Bit 0 opens the isolation,
      bit 10 is set once the PHY is configured.

  num-lanes:
    const: 1

required:
  - compatible
  - reg
  - reg-names
  - interrupts
  - interrupt-names
  - clocks
  - clock-names
  - reset-gpios
  - samsung,pmu-syscon

unevaluatedProperties: false

examples:
  - |
    #include <dt-bindings/clock/google,zumapro.h>
    #include <dt-bindings/gpio/gpio.h>
    #include <dt-bindings/interrupt-controller/arm-gic.h>

    soc {
        #address-cells = <2>;
        #size-cells = <1>;

        pcie@13120000 {
            compatible = "google,zumapro-pcie";
            reg = <0x0 0x13120000 0x2000>, <0x0 0x13130000 0x5000>,
                  <0x0 0x13150000 0xd000>, <0x0 0x13160000 0x3000>,
                  <0x0 0x13140000 0x5000>, <0x0 0x13100000 0x1000>,
                  <0x0 0x13400000 0x381000>, <0x0 0x60ffe000 0x2000>;
            reg-names = "elbi", "soc", "udbg", "phy", "pcs", "ia", "dbi",
                        "config";
            #address-cells = <3>;
            #size-cells = <2>;
            device_type = "pci";
            ranges = <0x82000000 0x0 0x60000000 0x0 0x60000000 0x0 0xff0000>;
            bus-range = <0x00 0xff>;
            interrupts = <GIC_SPI 439 IRQ_TYPE_LEVEL_HIGH>,
                         <GIC_SPI 441 IRQ_TYPE_LEVEL_HIGH>,
                         <GIC_SPI 442 IRQ_TYPE_LEVEL_HIGH>,
                         <GIC_SPI 443 IRQ_TYPE_LEVEL_HIGH>,
                         <GIC_SPI 444 IRQ_TYPE_LEVEL_HIGH>,
                         <GIC_SPI 445 IRQ_TYPE_LEVEL_HIGH>;
            interrupt-names = "ctrl", "msi0", "msi1", "msi2", "msi3", "msi4";
            clocks = <&cmu_hsi2 CLK_GOUT_PCIE1_CTL_APB>,
                     <&cmu_hsi2 CLK_GOUT_PCIE1_DBI_ACLK>,
                     <&cmu_hsi2 CLK_GOUT_PCIE1_SLV_ACLK>,
                     <&cmu_hsi2 CLK_GOUT_PCIE1_MSTR_ACLK>,
                     <&cmu_hsi2 CLK_GOUT_PCIE1_PHY_UDBG_APB>,
                     <&cmu_hsi2 CLK_GOUT_PCIE1_PHY_PAL_APB>,
                     <&cmu_hsi2 CLK_GOUT_PCIE1_PHY_REF>,
                     <&cmu_hsi2 CLK_GOUT_PCIE1_PHY_BRIDGE_APB>,
                     <&cmu_hsi2 CLK_GOUT_PCIE1_PHY_TEST_APB>,
                     <&cmu_hsi2 CLK_GOUT_PCIE1_IA_CLK>,
                     <&cmu_hsi2 CLK_GOUT_PCIE1_SSMT_IA_ACLK>,
                     <&cmu_hsi2 CLK_GOUT_PCIE1_SSMT_IA_PCLK>,
                     <&cmu_hsi2 CLK_GOUT_PCIE1_SYSMMU_CLK>,
                     <&cmu_hsi2 CLK_GOUT_PCIE1_PMMU_CLK>;
            clock-names = "ctl-apb", "dbi-aclk", "slv-aclk", "mstr-aclk",
                          "phy-udbg-apb", "phy-pal-apb", "phy-ref",
                          "phy-bridge-apb", "phy-test-apb", "ia-clk",
                          "ssmt-ia-aclk", "ssmt-ia-pclk", "sysmmu-clk",
                          "pmmu-clk";
            reset-gpios = <&gph3 0 GPIO_ACTIVE_LOW>;
            samsung,pmu-syscon = <&pmu_system_controller 0x3ec8>;
            num-lanes = <1>;
            max-link-speed = <2>;

            pcie@0,0 {
                compatible = "pciclass,0604";
                reg = <0x0 0x0 0x0 0x0 0x0>;
                #address-cells = <3>;
                #size-cells = <2>;
                device_type = "pci";
                bus-range = <0x01 0xff>;
                ranges;
                vpcie3v3-supply = <&wlan_reg_on>;
            };
        };
    };
```

## Documentation/devicetree/bindings/phy/google,gs201-mipi-dcphy-rx.yaml
```yaml
# SPDX-License-Identifier: GPL-2.0-only OR BSD-2-Clause
%YAML 1.2
---
$id: http://devicetree.org/schemas/phy/google,gs201-mipi-dcphy-rx.yaml#
$schema: http://devicetree.org/meta-schemas/core.yaml#

title: Google gs201 and zumapro MIPI DC-PHY receiver

maintainers:
  - Derek Ross <derekross@gmail.com>

description:
  The receive side of the Samsung MIPI DC-PHY in the camera block of Google's
  gs201 SoC, one combined D-PHY/C-PHY slave per CSIS link (links 0 and 1 with
  four data lanes, links 2-7 with two; links 2, 4 and 6 can take the next
  link's two data lanes as a four-lane receiver), a shared bias block and
  one PMU isolation control. The PHY cell selects the link. Each slave
  receives D-PHY or C-PHY (up to three trios on links 0 and 1, two on the
  others); the consumer selects the mode at run time, from its endpoint's
  bus type. zumapro (Tensor G4) has nine slaves for twelve CSIS links, the
  clock lane first on each, and one reset bit per slave; the PHY cell is
  the CSIS link.

properties:
  compatible:
    enum:
      - google,gs201-mipi-dcphy-rx
      - google,zumapro-mipi-dcphy-rx

  reg:
    maxItems: 1

  "#phy-cells":
    const: 1

  samsung,pmu-syscon:
    $ref: /schemas/types.yaml#/definitions/phandle-array
    items:
      - items:
          - description: PMU system controller
          - description: offset of the PHY isolation control
    description: The PMU register that releases the PHY from isolation.

  google,reset-sysreg:
    $ref: /schemas/types.yaml#/definitions/phandle-array
    items:
      - items:
          - description: the camera block's system registers
          - description: offset of the per-slave reset register (bit = slave)
    description:
      The register that holds each DC-PHY slave in reset (bit clear) or
      releases it (bit set).

  firmware-name:
    maxItems: 1
    description:
      The receive settings for D-PHY and C-PHY (bias and per-lane analog
      words, the HS settle count and skew delay by rate), which aren't
      public, as a data file loaded when a link first powers on. Without
      it no link powers on.

  power-domains:
    maxItems: 1

required:
  - compatible
  - reg
  - "#phy-cells"
  - samsung,pmu-syscon
  - firmware-name

additionalProperties: false

examples:
  - |
    phy@1a4f0000 {
        compatible = "google,gs201-mipi-dcphy-rx";
        reg = <0x1a4f0000 0x4000>;
        #phy-cells = <1>;
        samsung,pmu-syscon = <&pmu_system_controller 0x3ebc>;
        google,reset-sysreg = <&sysreg_csis 0x500>;
        firmware-name = "gs201-dcphy.bin";
    };
```

## Documentation/devicetree/bindings/phy/google,gs201-pcie-phy.yaml
```yaml
# SPDX-License-Identifier: (GPL-2.0-only OR BSD-2-Clause)
%YAML 1.2
---
$id: http://devicetree.org/schemas/phy/google,gs201-pcie-phy.yaml#
$schema: http://devicetree.org/meta-schemas/core.yaml#

title: Google gs201 PCIe PHY

maintainers:
  - Derek Ross <derekross@gmail.com>

description:
  The PCIe Gen4 PHY of the Google gs201 (Tensor G2) SoC. Each instance is a
  two-lane Samsung PHY with its PMA and PCS register blocks, a debug block
  that selects the reference clock, and three reset lines that live in the
  sub-control space of the PCIe controller it serves. Its isolation is
  controlled from the PMU.

properties:
  compatible:
    const: google,gs201-pcie-phy

  reg:
    items:
      - description: PMA registers
      - description: PCS registers
      - description: PHY reset registers in the controller's sub-control space
      - description: UDBG (reference clock and PLL selection) registers

  reg-names:
    items:
      - const: pma
      - const: pcs
      - const: rst
      - const: udbg

  clocks:
    minItems: 1
    maxItems: 5

  "#phy-cells":
    const: 0

  samsung,pmu-syscon:
    $ref: /schemas/types.yaml#/definitions/phandle-array
    items:
      - items:
          - description: phandle of the PMU system controller
          - description: offset of this PHY's control (isolation) register
    description:
      The PMU and the offset of PHY_CTRL_PCIE_GEN4_x for this instance.

required:
  - compatible
  - reg
  - reg-names
  - "#phy-cells"
  - samsung,pmu-syscon

additionalProperties: false

examples:
  - |
    #include <dt-bindings/clock/google,gs201.h>

    phy@14550000 {
        compatible = "google,gs201-pcie-phy";
        reg = <0x14550000 0x2000>, <0x14540000 0x1000>,
              <0x14521400 0x10>, <0x14560000 0xd000>;
        reg-names = "pma", "pcs", "rst", "udbg";
        clocks = <&cmu_hsi2 CLK_GOUT_HSI2_PCIE_GEN4_1_PCS_PMA_INST_0_PHY_UDBG_I_APB_PCLK>;
        samsung,pmu-syscon = <&pmu_system_controller 0x3ec4>;
        #phy-cells = <0>;
    };
```

## Documentation/devicetree/bindings/phy/google,zuma-pcie-phy.yaml
```yaml
# SPDX-License-Identifier: (GPL-2.0-only OR BSD-2-Clause)
%YAML 1.2
---
$id: http://devicetree.org/schemas/phy/google,zuma-pcie-phy.yaml#
$schema: http://devicetree.org/meta-schemas/core.yaml#

title: Google zuma PCIe Gen3 PHY

maintainers:
  - Brett-Michael Green <brett@bmgvisualtech.com>

description:
  The one-lane PCIe Gen3 PHY of the Google zuma (Tensor G3) SoC's second
  PCIe controller, which connects the Wi-Fi chip on Pixel 8 phones. Its
  reference clock comes from an external PLL in the UDBG block, selected as
  the PHY's input clock in the controller's SOC block. The PMU isolates the
  PHY until it is released. zumapro (Tensor G4) has the same PHY for its
  Wi-Fi controller, programmed with the same sequence, so it uses zuma's
  compatible as a fallback.

  zumapro's first PCIe controller, which connects the modem on the Pixel 9a,
  has a two-lane Gen3 PHY with the same register blocks. It has its own
  external PLL controls and power-down sequence and two lanes of PMA
  registers, so it has a compatible of its own.

properties:
  compatible:
    oneOf:
      - const: google,zuma-pcie-phy
      - items:
          - const: google,zumapro-pcie-phy
          - const: google,zuma-pcie-phy
      - const: google,zumapro-pcie-gen3x2-phy

  reg:
    items:
      - description: PMA registers
      - description: PCS registers
      - description: PHY reset registers in the controller's sub-control space
      - description: UDBG (external PLL) registers
      - description: SOC (PHY input clock selection) registers

  reg-names:
    items:
      - const: pma
      - const: pcs
      - const: rst
      - const: udbg
      - const: soc

  "#phy-cells":
    const: 0

  samsung,pmu-syscon:
    $ref: /schemas/types.yaml#/definitions/phandle-array
    items:
      - items:
          - description: phandle of the PMU system controller
          - description: offset of this PHY's control (isolation) register
    description:
      The PMU and the offset of this PHY's isolation control.

required:
  - compatible
  - reg
  - reg-names
  - "#phy-cells"
  - samsung,pmu-syscon

additionalProperties: false

examples:
  - |
    phy@13160000 {
        compatible = "google,zuma-pcie-phy";
        reg = <0x13160000 0x3000>, <0x13140000 0x5000>,
              <0x13121400 0x10>, <0x13150000 0xd000>,
              <0x13130000 0x5000>;
        reg-names = "pma", "pcs", "rst", "udbg", "soc";
        samsung,pmu-syscon = <&pmu_system_controller 0x3ec8>;
        #phy-cells = <0>;
    };
  - |
    phy@12140000 {
        compatible = "google,zumapro-pcie-gen3x2-phy";
        reg = <0x12140000 0x3000>, <0x12120000 0x5000>,
              <0x12101400 0x10>, <0x12130000 0xd000>,
              <0x12110000 0x5000>;
        reg-names = "pma", "pcs", "rst", "udbg", "soc";
        samsung,pmu-syscon = <&pmu_system_controller 0x3ec4>;
        #phy-cells = <0>;
    };
```
