## Documentation/devicetree/bindings/phy/ti,tusb2e11.yaml
```yaml
# SPDX-License-Identifier: (GPL-2.0-only OR BSD-2-Clause)
%YAML 1.2
---
$id: http://devicetree.org/schemas/phy/ti,tusb2e11.yaml#
$schema: http://devicetree.org/meta-schemas/core.yaml#

title: TI TUSB2E11 eUSB2 to USB 2.0 repeater

maintainers:
  - W4HO <87742609+W4HO-ham@users.noreply.github.com>

description:
  The TUSB2E11 converts between an SoC's eUSB2 signalling and USB 2.0 on
  one port. It takes its role, host or peripheral, from the eUSB2 link.
  The optional properties are the board's signal tuning, written to the
  repeater's register of the same name when the PHY is initialized; a
  property left out keeps the repeater's reset value.

properties:
  compatible:
    const: ti,tusb2e11

  reg:
    maxItems: 1

  "#phy-cells":
    const: 0

  vdd3v3-supply:
    description: 3.3 V supply

  ti,uart-port1:
    $ref: /schemas/types.yaml#/definitions/uint32
    maximum: 0xff
    description: UART_PORT1 (0x50), the port's mode control

  ti,usb2-tx-adjust:
    $ref: /schemas/types.yaml#/definitions/uint32
    maximum: 0xff
    description: U_TX_ADJUST_PORT1 (0x70)

  ti,usb2-hs-tx-pre-emphasis:
    $ref: /schemas/types.yaml#/definitions/uint32
    maximum: 0xff
    description: U_HS_TX_PRE_EMPHASIS_P1 (0x71)

  ti,usb2-rx-adjust:
    $ref: /schemas/types.yaml#/definitions/uint32
    maximum: 0xff
    description: U_RX_ADJUST_PORT1 (0x72)

  ti,usb2-disconnect-squelch:
    $ref: /schemas/types.yaml#/definitions/uint32
    maximum: 0xff
    description: U_DISCONNECT_SQUELCH_PORT1 (0x73)

  ti,eusb2-hs-tx-pre-emphasis:
    $ref: /schemas/types.yaml#/definitions/uint32
    maximum: 0xff
    description: E_HS_TX_PRE_EMPHASIS_P1 (0x77)

  ti,eusb2-tx-adjust:
    $ref: /schemas/types.yaml#/definitions/uint32
    maximum: 0xff
    description: E_TX_ADJUST_PORT1 (0x78)

  ti,eusb2-rx-adjust:
    $ref: /schemas/types.yaml#/definitions/uint32
    maximum: 0xff
    description: E_RX_ADJUST_PORT1 (0x79)

required:
  - compatible
  - reg
  - "#phy-cells"
  - vdd3v3-supply

additionalProperties: false

examples:
  - |
    i2c {
        #address-cells = <1>;
        #size-cells = <0>;

        usb-repeater@3e {
            compatible = "ti,tusb2e11";
            reg = <0x3e>;
            #phy-cells = <0>;
            vdd3v3-supply = <&vreg_l19m>;
            ti,uart-port1 = <0x0a>;
            ti,usb2-tx-adjust = <0x4f>;
            ti,usb2-hs-tx-pre-emphasis = <0x3c>;
        };
    };
...
```

## Documentation/devicetree/bindings/power/supply/maxim,max77779-charger.yaml
```yaml
# SPDX-License-Identifier: (GPL-2.0-only OR BSD-2-Clause)
%YAML 1.2
---
$id: http://devicetree.org/schemas/power/supply/maxim,max77779-charger.yaml#
$schema: http://devicetree.org/meta-schemas/core.yaml#

title: Maxim MAX77779 battery charger

maintainers:
  - W4HO <87742609+W4HO-ham@users.noreply.github.com>

description:
  The switching charger of the Maxim MAX77779 power management IC, on the
  same I2C bus as its fuel gauge. It charges the battery from USB and
  powers the system from it. The MAX77779's charger, fuel gauge and Type-C
  controller answer at their own I2C addresses with their own register
  maps, so each is described as its own I2C device rather than as a cell
  of one multi-function device.

allOf:
  - $ref: power-supply.yaml#

properties:
  compatible:
    const: maxim,max77779-charger

  reg:
    maxItems: 1

  interrupts:
    maxItems: 1
    description: The charger's interrupt, through the PMIC's interrupt
      controller.

  otg-boost-supply:
    description: An external boost that supplies VBUS to a device on the
      USB port. For host mode the charger is put in standby and this
      supply is enabled.

  chgin-otg-regulator:
    type: object
    $ref: /schemas/regulator/regulator.yaml#
    unevaluatedProperties: false
    description: VBUS out of the charger's input (CHGIN) for a device on
      the USB port, the supply of the Type-C controller's vbus. Only the
      Type-C controller turns it on, after it has seen VBUS at vSafe0V.
    properties:
      regulator-always-on: false
      regulator-boot-on: false

dependentRequired:
  chgin-otg-regulator: [ otg-boost-supply ]

required:
  - compatible
  - reg

unevaluatedProperties: false

examples:
  - |
    i2c {
        #address-cells = <1>;
        #size-cells = <0>;

        charger: charger@69 {
            compatible = "maxim,max77779-charger";
            reg = <0x69>;
            otg-boost-supply = <&otg_boost>;

            chgin-otg-regulator {
                regulator-name = "chgin-otg";
            };
        };

        fuel-gauge@36 {
            compatible = "maxim,max77779-fg";
            reg = <0x36>;
            shunt-resistor-micro-ohms = <2000>;
            power-supplies = <&charger>;
        };
    };
```

## Documentation/devicetree/bindings/power/supply/maxim,max77779-fg.yaml
```yaml
# SPDX-License-Identifier: (GPL-2.0-only OR BSD-2-Clause)
%YAML 1.2
---
$id: http://devicetree.org/schemas/power/supply/maxim,max77779-fg.yaml#
$schema: http://devicetree.org/meta-schemas/core.yaml#

title: Maxim MAX77779 fuel gauge

maintainers:
  - W4HO <87742609+W4HO-ham@users.noreply.github.com>

description:
  Fuel-gauge measurements from a MAX77779 with an initialized battery model.
  Firmware retains responsibility for model programming and charger control.

allOf:
  - $ref: power-supply.yaml#

properties:
  compatible:
    const: maxim,max77779-fg

  reg:
    maxItems: 1

  shunt-resistor-micro-ohms:
    description: Resistance of the battery current sense resistor in micro-ohms.
    minimum: 100
    maximum: 100000

required:
  - compatible
  - reg
  - shunt-resistor-micro-ohms

unevaluatedProperties: false

examples:
  - |
    i2c {
        #address-cells = <1>;
        #size-cells = <0>;

        fuel-gauge@36 {
            compatible = "maxim,max77779-fg";
            reg = <0x36>;
            shunt-resistor-micro-ohms = <2000>;
        };
    };
```

## Documentation/devicetree/bindings/regulator/samsung,s2mpg14-regulator.yaml
```yaml
# SPDX-License-Identifier: GPL-2.0-only OR BSD-2-Clause
%YAML 1.2
---
$id: http://devicetree.org/schemas/regulator/samsung,s2mpg14-regulator.yaml#
$schema: http://devicetree.org/meta-schemas/core.yaml#

title: Samsung S2MPG14 Power Management IC regulators

maintainers:
  - W4HO <87742609+W4HO-ham@users.noreply.github.com>

description: |
  S2MPG14 provides programmable voltage outputs. LDO4M and LDO25M supply
  touchscreen power; LDO8M, LDO9M and LDO19M supply eUSB2 PHY and repeater
  power on the Pixel 9a.

patternProperties:
  "^ldo(4|8|9|19|25)m$":
    type: object
    $ref: regulator.yaml#
    unevaluatedProperties: false
    properties:
      regulator-ramp-delay: false

additionalProperties: false
```

## Documentation/devicetree/bindings/regulator/samsung,s2mpg15-regulator.yaml
```yaml
# SPDX-License-Identifier: GPL-2.0-only OR BSD-2-Clause
%YAML 1.2
---
$id: http://devicetree.org/schemas/regulator/samsung,s2mpg15-regulator.yaml#
$schema: http://devicetree.org/meta-schemas/core.yaml#

title: Samsung S2MPG15 Power Management IC regulators

maintainers:
  - W4HO <87742609+W4HO-ham@users.noreply.github.com>

description: |
  The sub-PMIC paired with Google's Tensor G4. LDO5S and LDO7S supply the
  AoC sensors, LDO12S the camera sensors' 1.8 V and LDO15S the fingerprint
  sensor's 3.3 V. Enable control and voltage readback are supported; the
  firmware's voltage selections are preserved.

patternProperties:
  "^ldo(5|7|9|10|11|12|15)s$":
    type: object
    $ref: regulator.yaml#
    unevaluatedProperties: false
    properties:
      regulator-ramp-delay: false

additionalProperties: false
```

## Documentation/devicetree/bindings/soc/google/google,gs101-pmu.yaml
```yaml
# SPDX-License-Identifier: GPL-2.0-only OR BSD-2-Clause
%YAML 1.2
---
$id: http://devicetree.org/schemas/soc/google/google,gs101-pmu.yaml#
$schema: http://devicetree.org/meta-schemas/core.yaml#

title: Google GS101 Power Management Unit (PMU)

maintainers:
  - André Draszik <andre.draszik@linaro.org>

properties:
  compatible:
    oneOf:
      - const: google,gs101-pmu
      - items:
          - const: google,gs201-pmu
          - const: google,gs101-pmu

  reg:
    maxItems: 1

  "#address-cells":
    const: 1

  "#size-cells":
    const: 1

  ranges: true

  reboot-mode:
    $ref: /schemas/power/reset/syscon-reboot-mode.yaml
    type: object
    description:
      Reboot mode to alter bootloader behavior for the next boot
    patternProperties:
      # Negative look-ahead to disallow unsupported modes. The '$' has to be
      # part of lookahead group to work, instead of trailing outside of ().
      "^mode-(?!(bootloader$|charge$|dm-verity-device-corrupted$|fastboot$|reboot-ab-update$|recovery$)|rescue$|shutdown-thermal$|shutdown-thermal-battery$)": false

  syscon-poweroff:
    $ref: /schemas/power/reset/syscon-poweroff.yaml#
    type: object
    description:
      Node for power off method

  syscon-reboot:
    $ref: /schemas/power/reset/syscon-reboot.yaml#
    type: object
    description:
      Node for reboot method

  google,pmu-intr-gen-syscon:
    $ref: /schemas/types.yaml#/definitions/phandle
    description:
      Phandle to PMU interrupt generation interface.

patternProperties:
  "^power-domain@[0-9a-f]+$":
    type: object
    description: Child node describing one power domain within the PMU

    additionalProperties: true

    properties:
      compatible:
        const: google,gs101-pd

required:
  - compatible
  - reg
  - google,pmu-intr-gen-syscon

allOf:
  - if:
      properties:
        compatible:
          contains:
            const: google,gs201-pmu
    else:
      required:
        - "#address-cells"
        - "#size-cells"
        - ranges

additionalProperties: false

examples:
  - |
    system-controller@17460000 {
        compatible = "google,gs101-pmu";
        reg = <0x17460000 0x10000>;
        #address-cells = <1>;
        #size-cells = <1>;
        ranges = <0x0 0x17460000 0x10000>;

        google,pmu-intr-gen-syscon = <&pmu_intr_gen>;

        pd_g3d: power-domain@1e00 {
            compatible = "google,gs101-pd";
            reg = <0x1e00 0x80>;
            #power-domain-cells = <0>;
            label = "g3d";
            samsung,dtzpc = <&pd_g3d>;
        };

        power-domain@2000 {
            compatible = "google,gs101-pd";
            reg = <0x2000 0x80>;
            #power-domain-cells = <0>;
            power-domains = <&pd_g3d>;
            label = "embedded_g3d";
        };
    };
```

## Documentation/devicetree/bindings/soc/google/google,gs201-aoc-sysmmu.yaml
```yaml
# SPDX-License-Identifier: (GPL-2.0-only OR BSD-2-Clause)
%YAML 1.2
---
$id: http://devicetree.org/schemas/soc/google/google,gs201-aoc-sysmmu.yaml#
$schema: http://devicetree.org/meta-schemas/core.yaml#

title: Google gs201 AoC System MMU

maintainers:
  - Derek Ross <derekross@gmail.com>

description:
  The Samsung System MMU (version 8) in front of the gs201 AoC, the audio
  and sensor DSP. Only the AoC is behind it. It is programmed with the fixed
  translation windows the AoC firmware expects, by the AoC driver, while the
  AoC block is powered.

properties:
  compatible:
    const: google,gs201-aoc-sysmmu

  reg:
    maxItems: 1

  interrupts:
    description: the non-secure fault interrupt
    maxItems: 1

required:
  - compatible
  - reg
  - interrupts

additionalProperties: false

examples:
  - |
    #include <dt-bindings/interrupt-controller/arm-gic.h>
    sysmmu@1a090000 {
        compatible = "google,gs201-aoc-sysmmu";
        reg = <0x1a090000 0x10000>;
        interrupts = <GIC_SPI 118 IRQ_TYPE_LEVEL_HIGH>;
    };
```
