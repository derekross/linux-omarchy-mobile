## Documentation/devicetree/bindings/net/nfc/nxp,nci.yaml
```yaml
# SPDX-License-Identifier: GPL-2.0-only OR BSD-2-Clause
%YAML 1.2
---
$id: http://devicetree.org/schemas/net/nfc/nxp,nci.yaml#
$schema: http://devicetree.org/meta-schemas/core.yaml#

title: NXP Semiconductors NCI NFC controller

description:
  NFC controllers that speak plain NCI over I2C, with an enable line and an
  interrupt. Besides NXP's, ST's ST54L uses the same transport.

maintainers:
  - Krzysztof Kozlowski <krzk@kernel.org>

properties:
  compatible:
    oneOf:
      - const: nxp,nxp-nci-i2c
      - items:
          - enum:
              - nxp,nq310
              - nxp,pn547
              - nxp,pn553
              - nxp,pn557
              - st,st54l
          - const: nxp,nxp-nci-i2c

  clocks:
    maxItems: 1
    description: The controller's reference clock, or the SoC clock pad
      that feeds it on the controller's request

  enable-gpios:
    description: Output GPIO pin used for enabling/disabling the controller

  firmware-gpios:
    description: Output GPIO pin used to enter firmware download mode

  interrupts:
    maxItems: 1

  reg:
    maxItems: 1

required:
  - compatible
  - enable-gpios
  - interrupts
  - reg

additionalProperties: false

examples:
  - |
    #include <dt-bindings/gpio/gpio.h>
    #include <dt-bindings/interrupt-controller/irq.h>

    i2c {
        #address-cells = <1>;
        #size-cells = <0>;

        nfc@29 {
            compatible = "nxp,nxp-nci-i2c";

            reg = <0x29>;

            interrupt-parent = <&gpio1>;
            interrupts = <29 IRQ_TYPE_LEVEL_HIGH>;

            enable-gpios = <&gpio0 30 GPIO_ACTIVE_HIGH>;
            firmware-gpios = <&gpio0 31 GPIO_ACTIVE_HIGH>;
        };
    };
```

## Documentation/devicetree/bindings/pci/google,gs201-pcie-cp.yaml
```yaml
# SPDX-License-Identifier: (GPL-2.0-only OR BSD-2-Clause)
%YAML 1.2
---
$id: http://devicetree.org/schemas/pci/google,gs201-pcie-cp.yaml#
$schema: http://devicetree.org/meta-schemas/core.yaml#

title: Google gs201 PCIe GEN4A_0 (modem link)

maintainers:
  - Derek Ross <derekross@gmail.com>

description: |
  PCIe GEN4A_0 in the HSI1 block of Google's gs201 (Tensor G2), a DesignWare
  root complex with two lanes that connects the Samsung S5300 modem. Its
  outbound address translation is owned by the secure monitor, which maps
  the endpoint's configuration space at the "config" window and its memory
  at a fixed window. The modem's control lines are described in a "modem"
  child node.

allOf:
  - $ref: /schemas/pci/pci-host-bridge.yaml#

properties:
  compatible:
    const: google,gs201-pcie-cp

  reg:
    items:
      - description: sub-controller (ELBI) registers
      - description: DesignWare DBI registers
      - description: endpoint configuration space window
      - description: I/A sequencer registers

  reg-names:
    items:
      - const: elbi
      - const: dbi
      - const: config
      - const: ia

  interrupts:
    items:
      - description: controller events
      - description: MSI block 0
      - description: MSI block 1
      - description: MSI block 2
      - description: MSI block 3
      - description: MSI block 4

  interrupt-names:
    items:
      - const: ctrl
      - const: msi0
      - const: msi1
      - const: msi2
      - const: msi3
      - const: msi4

  phys:
    maxItems: 1

  phy-names:
    const: pcie

  pinctrl-0: true
  pinctrl-names:
    const: active

  reset-gpios:
    maxItems: 1
    description: PERST#

  num-lanes:
    const: 2

  max-link-speed:
    const: 3

  samsung,pmu-syscon:
    $ref: /schemas/types.yaml#/definitions/phandle-array
    items:
      - items:
          - description: PMU
          - description: offset of the PHY isolation control register
    description:
      PMU and the PHY isolation control register. The PHY driver releases
      isolation; this controller sets it again once the link is down.

  memory-region:
    maxItems: 1
    description:
      The modem's MSI target page. The DesignWare MSI block terminates the
      MSI writes to it; the modem also writes its boot stage into the page,
      so it must be reserved RAM.

  samsung,sysreg:
    $ref: /schemas/types.yaml#/definitions/phandle-array
    items:
      - items:
          - description: HSI1 system registers
          - description: offset of the shareability control register
    description: SYSREG_HSI1 and its PCIe shareability (I/O coherency) register.

  modem:
    type: object
    additionalProperties: false
    description:
      The modem's power, reset and handshake lines (raw levels), for
      driving the modem without its own driver. When the modem driver
      describes the lines in its own node instead, this node is absent or
      disabled, so that each line has one owner.
    properties:
      compatible:
        const: samsung,s5300-modem
      status: true
      ap2cp-pda-active-gpios:
        maxItems: 1
      ap2cp-cp-pwr-on-gpios:
        maxItems: 1
      ap2cp-nreset-gpios:
        maxItems: 1
      ap2cp-cp-wrst-gpios:
        maxItems: 1
      ap2cp-pm-wrst-gpios:
        maxItems: 1
      ap2cp-wakeup-gpios:
        maxItems: 1
      ap2cp-dump-noti-gpios:
        maxItems: 1
      cp2ap-cp-wrst-gpios:
        maxItems: 1
      cp2ap-ps-hold-gpios:
        maxItems: 1
      cp2ap-wakeup-gpios:
        maxItems: 1
      cp2ap-phone-active-gpios:
        maxItems: 1
    required:
      - compatible
      - ap2cp-pda-active-gpios
      - ap2cp-cp-pwr-on-gpios
      - ap2cp-nreset-gpios
      - ap2cp-cp-wrst-gpios
      - ap2cp-pm-wrst-gpios
      - ap2cp-wakeup-gpios
      - ap2cp-dump-noti-gpios
      - cp2ap-cp-wrst-gpios
      - cp2ap-ps-hold-gpios
      - cp2ap-wakeup-gpios
      - cp2ap-phone-active-gpios

required:
  - compatible
  - reg
  - reg-names
  - interrupts
  - phys
  - reset-gpios
  - samsung,pmu-syscon
  - samsung,sysreg

unevaluatedProperties: false

examples:
  - |
    #include <dt-bindings/gpio/gpio.h>
    #include <dt-bindings/interrupt-controller/arm-gic.h>

    pcie@11920000 {
        compatible = "google,gs201-pcie-cp";
        #address-cells = <3>;
        #size-cells = <2>;
        device_type = "pci";
        ranges = <0x82000000 0x0 0x14e00000 0x40000000 0x0 0xff0000>;
        bus-range = <0x00 0xff>;
        reg = <0x11920000 0x1400>, <0x11c00000 0x301000>,
              <0x40ffe000 0x2000>, <0x11900000 0x1000>;
        reg-names = "elbi", "dbi", "config", "ia";
        interrupts = <GIC_SPI 388 IRQ_TYPE_LEVEL_HIGH>,
                     <GIC_SPI 389 IRQ_TYPE_LEVEL_HIGH>,
                     <GIC_SPI 390 IRQ_TYPE_LEVEL_HIGH>,
                     <GIC_SPI 391 IRQ_TYPE_LEVEL_HIGH>,
                     <GIC_SPI 392 IRQ_TYPE_LEVEL_HIGH>,
                     <GIC_SPI 393 IRQ_TYPE_LEVEL_HIGH>;
        interrupt-names = "ctrl", "msi0", "msi1", "msi2", "msi3", "msi4";
        phys = <&pcie_0_phy>;
        phy-names = "pcie";
        memory-region = <&cp_msi_mem>;
        reset-gpios = <&gph0 0 GPIO_ACTIVE_LOW>;
        samsung,pmu-syscon = <&pmu_system_controller 0x3ec0>;
        samsung,sysreg = <&sysreg_hsi1 0x704>;
        num-lanes = <2>;
        max-link-speed = <3>;

        modem {
            compatible = "samsung,s5300-modem";
            ap2cp-pda-active-gpios = <&gph1 1 GPIO_ACTIVE_HIGH>;
            ap2cp-cp-pwr-on-gpios = <&gph1 2 GPIO_ACTIVE_HIGH>;
            ap2cp-nreset-gpios = <&gph1 3 GPIO_ACTIVE_HIGH>;
            ap2cp-cp-wrst-gpios = <&gph1 6 GPIO_ACTIVE_HIGH>;
            ap2cp-pm-wrst-gpios = <&gpa0 3 GPIO_ACTIVE_HIGH>;
            ap2cp-wakeup-gpios = <&gph0 2 GPIO_ACTIVE_HIGH>;
            ap2cp-dump-noti-gpios = <&gph0 3 GPIO_ACTIVE_HIGH>;
            cp2ap-cp-wrst-gpios = <&gpa0 2 GPIO_ACTIVE_HIGH>;
            cp2ap-ps-hold-gpios = <&gpa8 2 GPIO_ACTIVE_HIGH>;
            cp2ap-wakeup-gpios = <&gpa8 3 GPIO_ACTIVE_HIGH>;
            cp2ap-phone-active-gpios = <&gpa8 4 GPIO_ACTIVE_HIGH>;
        };
    };
```

## Documentation/devicetree/bindings/pci/google,gs201-pcie.yaml
```yaml
# SPDX-License-Identifier: (GPL-2.0-only OR BSD-2-Clause)
%YAML 1.2
---
$id: http://devicetree.org/schemas/pci/google,gs201-pcie.yaml#
$schema: http://devicetree.org/meta-schemas/core.yaml#

title: Google gs201 and zuma PCIe host controllers

maintainers:
  - Derek Ross <derekross@gmail.com>

description:
  The PCIe controllers of the Google gs201 (Tensor G2) and zuma (Tensor G3)
  SoCs are Synopsys DesignWare cores (IP versions 0x984500 and 0x986500) in
  a Samsung wrapper. The wrapper
  adds a sub-control block (ELBI) with link training control and interrupt
  status, and an I/A sequencer that re-locks the PHY clock-data recovery when
  the link leaves L1.2. zuma's Wi-Fi controller runs without the I/A, as on
  stock. Legacy INTx interrupts are demultiplexed from the controller
  interrupt by a child interrupt controller.

allOf:
  - $ref: /schemas/pci/pci-host-bridge.yaml#
  - $ref: /schemas/pci/snps,dw-pcie-common.yaml#
  - if:
      properties:
        compatible:
          const: google,zuma-pcie
    then:
      properties:
        reg:
          maxItems: 3
        reg-names:
          maxItems: 3

properties:
  compatible:
    enum:
      - google,gs201-pcie
      - google,zuma-pcie

  reg:
    minItems: 3
    items:
      - description: External local bus interface (ELBI) registers
      - description: Data Bus Interface (DBI) registers, with the unrolled
          iATU at offset 0x300000
      - description: PCIe configuration space region
      - description: I/A sequencer registers

  reg-names:
    minItems: 3
    items:
      - const: elbi
      - const: dbi
      - const: config
      - const: ia

  interrupts:
    maxItems: 1

  clocks:
    minItems: 1
    maxItems: 8

  phys:
    maxItems: 1

  phy-names:
    const: pcie

  dma-coherent: true

  samsung,cmu:
    $ref: /schemas/types.yaml#/definitions/phandle
    description:
      The HSI clock controller (CMU) of this controller. Google's driver
      turns the CMU's global automatic clock gating off before using the
      controller; the driver can do the same, and reads the PCIe gate and
      Q-channel state from it for diagnostics.

  samsung,sysreg:
    $ref: /schemas/types.yaml#/definitions/phandle-array
    items:
      - items:
          - description: phandle of the HSI system register controller
          - description: offset of this controller's shareability register
    description:
      Needed with dma-coherent, to make the controller's DMA shareable.

  num-lanes:
    maximum: 2

  max-link-speed:
    maximum: 4

  legacy-interrupt-controller:
    type: object
    additionalProperties: false

    properties:
      "#address-cells":
        const: 0

      interrupt-controller: true

      "#interrupt-cells":
        const: 1

    required:
      - "#address-cells"
      - interrupt-controller
      - "#interrupt-cells"

required:
  - compatible
  - reg
  - reg-names
  - interrupts
  - "#interrupt-cells"
  - interrupt-map
  - interrupt-map-mask
  - phys
  - phy-names
  - reset-gpios
  - legacy-interrupt-controller

unevaluatedProperties: false

examples:
  - |
    #include <dt-bindings/clock/google,gs201.h>
    #include <dt-bindings/gpio/gpio.h>
    #include <dt-bindings/interrupt-controller/arm-gic.h>

    soc {
        #address-cells = <1>;
        #size-cells = <1>;

        pcie@14520000 {
            compatible = "google,gs201-pcie";
            reg = <0x14520000 0x1400>, <0x14800000 0x301000>,
                  <0x60ffe000 0x2000>, <0x14500000 0x1000>;
            reg-names = "elbi", "dbi", "config", "ia";
            #address-cells = <3>;
            #size-cells = <2>;
            device_type = "pci";
            ranges = <0x82000000 0x0 0x60000000 0x60000000 0x0 0xff0000>;
            bus-range = <0x00 0xff>;
            interrupts = <GIC_SPI 428 IRQ_TYPE_LEVEL_HIGH>;
            #interrupt-cells = <1>;
            interrupt-map-mask = <0 0 0 7>;
            interrupt-map = <0 0 0 1 &pcie_1_intc 0>,
                            <0 0 0 2 &pcie_1_intc 1>,
                            <0 0 0 3 &pcie_1_intc 2>,
                            <0 0 0 4 &pcie_1_intc 3>;
            clocks = <&cmu_hsi2 CLK_GOUT_HSI2_PCIE_GEN4_1_PCIE_003_G4X2_DWC_PCIE_CTL_INST_0_DBI_ACLK_UG>;
            phys = <&pcie_1_phy>;
            phy-names = "pcie";
            reset-gpios = <&gph2 0 GPIO_ACTIVE_LOW>;
            samsung,cmu = <&cmu_hsi2>;
            samsung,sysreg = <&sysreg_hsi2 0x730>;
            dma-coherent;
            num-lanes = <1>;
            max-link-speed = <2>;

            pcie_1_intc: legacy-interrupt-controller {
                #address-cells = <0>;
                interrupt-controller;
                #interrupt-cells = <1>;
            };
        };
    };
```
