## Documentation/devicetree/bindings/soc/google/google,gs201-aoc.yaml
```yaml
# SPDX-License-Identifier: (GPL-2.0-only OR BSD-2-Clause)
%YAML 1.2
---
$id: http://devicetree.org/schemas/soc/google/google,gs201-aoc.yaml#
$schema: http://devicetree.org/meta-schemas/core.yaml#

title: Google Tensor AoC (Always-on Compute)

maintainers:
  - Derek Ross <derekross@gmail.com>

description:
  The AoC is the audio and sensor DSP of Tensor SoCs. The AP loads its
  firmware into a reserved carve-out and the GSA authenticates and starts
  it. On gs201 the AoC reaches memory through its own System MMU, which
  Linux sets up. On zumapro (Tensor G4) the authenticated firmware owns
  the AoC's memory protection, so Linux touches neither its S2MPU nor its
  System MMU.

properties:
  compatible:
    enum:
      - google,gs201-aoc
      - google,zumapro-aoc

  reg:
    minItems: 2
    maxItems: 4

  reg-names:
    minItems: 2
    maxItems: 4

  clocks:
    description: the ACPM DVFS domains whose rates are read before each
      firmware start
    minItems: 1
    maxItems: 17

  firmware-name:
    maxItems: 1
    description: the signed AoC firmware image

  sensor-1v8-supply:
    description: the sensors' 1.8 V, turned on before the 3.3 V

  sensor-3v3-supply:
    description: the sensors' 3.3 V, turned off before the 1.8 V

  interrupts:
    maxItems: 1

  mboxes:
    description: the 48 doorbell channels of the three AoC mailboxes (A32,
      F1, P6), 16 each, in that order
    maxItems: 48

  interrupt-names:
    items:
      - const: watchdog

  memory-region:
    maxItems: 1
    description: the carve-out the firmware runs from

  google,gsa:
    $ref: /schemas/types.yaml#/definitions/phandle
    description: the GSA that authenticates and starts the firmware

  google,sysmmu:
    $ref: /schemas/types.yaml#/definitions/phandle
    description: the AoC's System MMU

  google,board-id:
    $ref: /schemas/types.yaml#/definitions/uint32
    description: board id passed to the firmware

  google,board-rev:
    $ref: /schemas/types.yaml#/definitions/uint32
    description: board revision passed to the firmware

  google,gnss-type:
    $ref: /schemas/types.yaml#/definitions/uint32
    description: the board's GNSS receiver, passed to the firmware
      (kAOCGnssType)

required:
  - compatible
  - reg
  - reg-names
  - memory-region
  - google,gsa
  - google,board-id
  - google,board-rev

allOf:
  - if:
      properties:
        compatible:
          const: google,zumapro-aoc
    then:
      properties:
        reg:
          items:
            - description: the AoC power request register (aoc_req) and its
                acknowledge at +0x40
            - description: the chip id block, read for the firmware's boot
                parameters
        reg-names:
          items:
            - const: aoc_req
            - const: chipid
        mboxes:
          minItems: 48
        google,sysmmu: false
      required:
        - firmware-name
        - interrupts
        - interrupt-names
        - mboxes
        - sensor-1v8-supply
        - sensor-3v3-supply
    else:
      properties:
        reg:
          minItems: 3
          items:
            - description: the AoC power request register (aoc_req) and its
                acknowledge at +0x40
            - description: the AoC's stage-2 MPU
            - description: the chip id block, read for the firmware's boot
                parameters
            - description: the AoC power control unit (A32 reset control and
                revision), in the AoC block
        reg-names:
          minItems: 3
          items:
            - const: aoc_req
            - const: s2mpu
            - const: chipid
            - const: pcu
        clocks: false
        sensor-1v8-supply: false
        sensor-3v3-supply: false
      required:
        - google,sysmmu

additionalProperties: false

examples:
  - |
    #include <dt-bindings/interrupt-controller/arm-gic.h>
    aoc@181d0000 {
        compatible = "google,gs201-aoc";
        reg = <0x181d0000 0x1000>, <0x1a0b0000 0x1000>, <0x10000000 0x100>,
              <0x19a00000 0x10000>;
        reg-names = "aoc_req", "s2mpu", "chipid", "pcu";
        interrupts = <GIC_SPI 116 IRQ_TYPE_LEVEL_HIGH>;
        interrupt-names = "watchdog";
        memory-region = <&aoc_carveout>;
        google,gsa = <&gsa>;
        google,sysmmu = <&aoc_sysmmu>;
        google,board-id = <0x30301>;
        google,board-rev = <0x10000>;
    };
```

## Documentation/devicetree/bindings/soc/google/google,gs201-camera-power-test.yaml
```yaml
# SPDX-License-Identifier: GPL-2.0-only OR BSD-2-Clause
%YAML 1.2
---
$id: http://devicetree.org/schemas/soc/google/google,gs201-camera-power-test.yaml#
$schema: http://devicetree.org/meta-schemas/core.yaml#

title: Google gs201 camera module power test (bring-up)

maintainers:
  - Derek Ross <derekross@gmail.com>

description:
  Bring-up only, until there are sensor drivers. Describes one I2C device of
  a camera module (sensor or module EEPROM) with its supplies in power-up
  order, master clock, reset line and the identification registers that may
  be read from it.

properties:
  compatible:
    const: google,gs201-camera-power-test

  reg:
    maxItems: 1

  clocks:
    maxItems: 1
    description: Sensor master clock.

  pinctrl-0: true
  pinctrl-1: true

  pinctrl-names:
    items:
      - const: on
      - const: off

  reset-gpios:
    maxItems: 1
    description: Asserted holds the sensor in reset.

  google,supply-names:
    $ref: /schemas/types.yaml#/definitions/string-array
    minItems: 1
    maxItems: 8
    description: Supplies in power-up order, each named <name>-supply.

  google,supply-on-delays-us:
    minItems: 1
    maxItems: 8
    description: Wait after enabling each supply.

  google,supply-off-delays-us:
    minItems: 1
    maxItems: 8
    description: Wait after disabling each supply.

  google,mclk-delay-us:
    description: Wait after the master clock starts.

  google,reset-delay-us:
    description: Wait after reset is released.

  google,reset-before-mclk:
    type: boolean
    description: Release reset before the master clock starts.

  google,readable-registers:
    $ref: /schemas/types.yaml#/definitions/uint32-array
    minItems: 1
    maxItems: 16
    description: 16-bit register addresses that may be read.

  google,reg-value-bytes:
    $ref: /schemas/types.yaml#/definitions/uint32
    description: Width of a register value.
    enum: [1, 2]
    default: 1

patternProperties:
  "-supply$": true

required:
  - compatible
  - reg
  - google,supply-names
  - google,supply-on-delays-us
  - google,supply-off-delays-us

additionalProperties: false

examples:
  - |
    #include <dt-bindings/gpio/gpio.h>
    i2c {
        #address-cells = <1>;
        #size-cells = <0>;

        camera@1a {
            compatible = "google,gs201-camera-power-test";
            reg = <0x1a>;
            clocks = <&mclk>;
            pinctrl-names = "on", "off";
            pinctrl-0 = <&mclk_on>;
            pinctrl-1 = <&mclk_off>;
            reset-gpios = <&gpp6 3 GPIO_ACTIVE_LOW>;
            google,supply-names = "pp3200", "pp1300", "dovdd", "dvdd", "avdd";
            pp3200-supply = <&pp3200_bb_cam>;
            pp1300-supply = <&pp1300_cam>;
            dovdd-supply = <&ldo12s>;
            dvdd-supply = <&cam_ldo6>;
            avdd-supply = <&cam_ldo2>;
            google,supply-on-delays-us = <0 0 0 0 1000>;
            google,supply-off-delays-us = <0 0 1000 0 0>;
            google,mclk-delay-us = <1000>;
            google,reset-delay-us = <10000>;
            google,readable-registers = <0x0016 0x0017>;
        };
    };
```
