## Documentation/devicetree/bindings/input/cirrus,cs40l26.yaml
```yaml
# SPDX-License-Identifier: GPL-2.0-only OR BSD-2-Clause
%YAML 1.2
---
$id: http://devicetree.org/schemas/input/cirrus,cs40l26.yaml#
$schema: http://devicetree.org/meta-schemas/core.yaml#

title: Cirrus Logic CS40L26 Boosted Haptic Driver

maintainers:
  - Derek Ross <derekross@gmail.com>

description:
  The CS40L26 drives a linear resonant actuator (LRA) from a boost converter
  and a class-D amplifier under the control of an integrated Halo Core DSP,
  which runs a ROM firmware out of reset and a RAM firmware loaded by the
  host. It is controlled over I2C.

properties:
  compatible:
    enum:
      - cirrus,cs40l26a

  reg:
    maxItems: 1

  interrupts:
    maxItems: 1

  reset-gpios:
    maxItems: 1

  vdd-a-supply:
    description: Power supply for internal analog circuits.

  vdd-p-supply:
    description: Power supply for the amplifier and the boost converter input.

  cirrus,boost-peak-microamp:
    description: Peak current limit of the boost inductor.
    minimum: 800000
    maximum: 4800000
    multipleOf: 50000
    default: 4500000

  cirrus,boost-ctl-microvolt:
    description: Maximum boost converter output voltage.
    minimum: 2500000
    maximum: 11000000
    multipleOf: 50000
    default: 11000000

  cirrus,vpbr-threshold-microvolt:
    description:
      Enable hardware attenuation when the amplifier and boost input supply
      falls below this voltage. The attack, hold and release policy uses the
      Cirrus default settings. If absent, leave VP brownout prevention unchanged.
    minimum: 2497000
    maximum: 3874000
    multipleOf: 47000

  cirrus,lra-f0-hz:
    description: Nominal resonant frequency of the actuator.
    minimum: 50
    maximum: 500

  cirrus,lra-redc-micro-ohms:
    description: Nominal DC resistance of the actuator.
    maximum: 255000000

required:
  - compatible
  - reg
  - interrupts
  - reset-gpios

additionalProperties: false

examples:
  - |
    #include <dt-bindings/gpio/gpio.h>
    #include <dt-bindings/interrupt-controller/irq.h>

    i2c {
      #address-cells = <1>;
      #size-cells = <0>;

      haptic-driver@43 {
        compatible = "cirrus,cs40l26a";
        reg = <0x43>;
        interrupt-parent = <&gpio>;
        interrupts = <1 IRQ_TYPE_LEVEL_LOW>;
        reset-gpios = <&gpio 3 GPIO_ACTIVE_LOW>;
        cirrus,boost-peak-microamp = <2500000>;
        cirrus,boost-ctl-microvolt = <11000000>;
        cirrus,lra-f0-hz = <145>;
        cirrus,lra-redc-micro-ohms = <13000000>;
      };
    };
```

## Documentation/devicetree/bindings/input/touchscreen/focaltech,ft3658.yaml
```yaml
# SPDX-License-Identifier: GPL-2.0-only OR BSD-2-Clause
%YAML 1.2
---
$id: http://devicetree.org/schemas/input/touchscreen/focaltech,ft3658.yaml#
$schema: http://devicetree.org/meta-schemas/core.yaml#

title: FocalTech FT3658 SPI touch controller

maintainers:
  - Alejandro Garcia <skipper.pelygro@gmail.com>

description:
  FocalTech FT3658 capacitive touch controller on SPI, as in the Google
  Pixel 7. The controller runs its firmware from its own flash and reports
  up to ten touches. The I2C FocalTech controllers are covered by
  edt-ft5x06.yaml and are different devices.

allOf:
  - $ref: /schemas/spi/spi-peripheral-props.yaml#
  - $ref: touchscreen.yaml#

properties:
  compatible:
    const: focaltech,ft3658

  reg:
    maxItems: 1

  interrupts:
    maxItems: 1

  vdd-supply:
    description: Digital supply (1.8 V)

  avdd-supply:
    description: Analog supply

  reset-gpios:
    description: Active-low reset
    maxItems: 1

  spi-max-frequency: true

required:
  - compatible
  - reg
  - interrupts
  - vdd-supply
  - avdd-supply
  - reset-gpios
  - touchscreen-size-x
  - touchscreen-size-y

unevaluatedProperties: false

examples:
  - |
    #include <dt-bindings/gpio/gpio.h>
    #include <dt-bindings/interrupt-controller/irq.h>

    spi {
        #address-cells = <1>;
        #size-cells = <0>;

        touchscreen@0 {
            compatible = "focaltech,ft3658";
            reg = <0>;
            spi-max-frequency = <10000000>;
            interrupt-parent = <&gpa7>;
            interrupts = <0 IRQ_TYPE_EDGE_FALLING>;
            vdd-supply = <&ldo25m>;
            avdd-supply = <&ldo26m>;
            reset-gpios = <&gpp23 2 GPIO_ACTIVE_LOW>;
            touchscreen-size-x = <1080>;
            touchscreen-size-y = <2400>;
        };
    };
```

## Documentation/devicetree/bindings/input/touchscreen/samsung,s6sy761.yaml
```yaml
# SPDX-License-Identifier: (GPL-2.0-only OR BSD-2-Clause)
%YAML 1.2
---
$id: http://devicetree.org/schemas/input/touchscreen/samsung,s6sy761.yaml#
$schema: http://devicetree.org/meta-schemas/core.yaml#

title: Samsung S6SY761 and S6SY79x touchscreen controllers

description:
  The S6SY761 is connected over I2C. The S6SY79x speaks the same command
  set over SPI, with Samsung's framing.

maintainers:
  - Andi Shyti <andi.shyti@kernel.org>

allOf:
  - $ref: touchscreen.yaml#
  - $ref: /schemas/spi/spi-peripheral-props.yaml#

properties:
  compatible:
    enum:
      - samsung,s6sy761
      - samsung,s6sy79x

  reg:
    maxItems: 1

  interrupts:
    maxItems: 1

  reset-gpios:
    maxItems: 1

  spi-cpha: true
  spi-cpol: true

  avdd-supply: true
  vdd-supply: true

unevaluatedProperties: false

required:
  - compatible
  - reg
  - interrupts
  - avdd-supply
  - vdd-supply

examples:
  - |
    #include <dt-bindings/interrupt-controller/irq.h>
    i2c {
        #address-cells = <1>;
        #size-cells = <0>;

        touchscreen@48 {
            compatible = "samsung,s6sy761";
            reg = <0x48>;
            interrupt-parent = <&gpa1>;
            interrupts = <1 IRQ_TYPE_LEVEL_HIGH>;
            avdd-supply = <&ldo30_reg>;
            vdd-supply = <&ldo31_reg>;
            touchscreen-size-x = <4096>;
            touchscreen-size-y = <4096>;
        };
    };
  - |
    #include <dt-bindings/gpio/gpio.h>
    #include <dt-bindings/interrupt-controller/irq.h>
    spi {
        #address-cells = <1>;
        #size-cells = <0>;

        touchscreen@0 {
            compatible = "samsung,s6sy79x";
            reg = <0>;
            spi-max-frequency = <10000000>;
            spi-cpol;
            spi-cpha;
            interrupt-parent = <&gpa9>;
            interrupts = <0 IRQ_TYPE_LEVEL_LOW>;
            reset-gpios = <&gpp26 0 GPIO_ACTIVE_LOW>;
            avdd-supply = <&ldo26m>;
            vdd-supply = <&ldo25m>;
            touchscreen-size-x = <1440>;
            touchscreen-size-y = <3120>;
        };
    };
```

## Documentation/devicetree/bindings/input/touchscreen/st,salixp.yaml
```yaml
# SPDX-License-Identifier: GPL-2.0-only OR BSD-2-Clause
%YAML 1.2
---
$id: http://devicetree.org/schemas/input/touchscreen/st,salixp.yaml#
$schema: http://devicetree.org/meta-schemas/core.yaml#

title: STMicroelectronics SALIXP and ALIX SPI touch controllers

maintainers:
  - David A. Buser <code@booze.dog>

description:
  STMicroelectronics SALIXP touch controller on SPI. SALIXP is the FTS
  part whose chip id is 36 40; ALIX has chip id 36 48. The I2C
  FingerTip controller is st,stmfts and is a different device.

allOf:
  - $ref: /schemas/spi/spi-peripheral-props.yaml#
  - $ref: touchscreen.yaml#
  - if:
      properties:
        compatible:
          const: st,alix
    then:
      required:
        - bus-request-gpios
        - bus-ack-gpios

properties:
  compatible:
    enum:
      - st,salixp
      - st,alix

  reg:
    maxItems: 1

  interrupts:
    maxItems: 1

  vdd-supply: true

  avdd-supply: true

  reset-gpios:
    description: Active-low reset
    maxItems: 1

  bus-request-gpios:
    description: Active-low AP bus request
    maxItems: 1

  bus-ack-gpios:
    description: Active-low acknowledgment of AP bus ownership
    maxItems: 1

  spi-max-frequency: true

required:
  - compatible
  - reg
  - interrupts
  - vdd-supply
  - avdd-supply
  - reset-gpios
  - spi-max-frequency
  - touchscreen-size-x
  - touchscreen-size-y

unevaluatedProperties: false

examples:
  - |
    #include <dt-bindings/gpio/gpio.h>
    #include <dt-bindings/interrupt-controller/irq.h>

    spi {
        #address-cells = <1>;
        #size-cells = <0>;

        touchscreen@0 {
            compatible = "st,salixp";
            reg = <0>;
            spi-max-frequency = <10000000>;
            interrupt-parent = <&gpa6>;
            interrupts = <7 IRQ_TYPE_LEVEL_LOW>;
            vdd-supply = <&ldo25m>;
            avdd-supply = <&ldo26m>;
            reset-gpios = <&gpp23 3 GPIO_ACTIVE_LOW>;
            touchscreen-size-x = <1080>;
            touchscreen-size-y = <2092>;
        };
    };
```

## Documentation/devicetree/bindings/input/touchscreen/synaptics,tcm-spi-hbp.yaml
```yaml
# SPDX-License-Identifier: (GPL-2.0-only OR BSD-2-Clause)
%YAML 1.2
---
$id: http://devicetree.org/schemas/input/touchscreen/synaptics,tcm-spi-hbp.yaml#
$schema: http://devicetree.org/meta-schemas/core.yaml#

title: Synaptics TouchComm SPI HBP touchscreen (S3910 and similar)

maintainers:
  - Martin Lund <mrlund@hotmail.com>

description: |
  Synaptics touchscreen controllers that use the TouchComm host-based
  protocol over SPI. Bound by drivers/input/touchscreen/syna_tcm2_spi.c
  as compatible "synaptics,tcm-spi-hbp" (OnePlus 13 S3910).

  Panel size and TX/RX counts stay as vendor properties because the
  carried Synaptics driver reads them via of_property_read_u32_array
  rather than touchscreen_parse_properties(). Reset/AVDD/IRQ similarly
  use the driver's own GPIO helpers.

allOf:
  - $ref: touchscreen.yaml#
  - $ref: /schemas/spi/spi-peripheral-props.yaml#

properties:
  compatible:
    const: synaptics,tcm-spi-hbp

  reg:
    maxItems: 1

  interrupts:
    maxItems: 1

  vdd-supply: true

  synaptics,irq-gpio:
    $ref: /schemas/types.yaml#/definitions/phandle-array
    description: ATTN GPIO (duplicates interrupts for the vendor driver)
    maxItems: 1

  synaptics,reset-gpio:
    $ref: /schemas/types.yaml#/definitions/phandle-array
    description: Reset GPIO
    maxItems: 1

  synaptics,avdd-gpio:
    $ref: /schemas/types.yaml#/definitions/phandle-array
    description: AVDD enable GPIO
    maxItems: 1

  synaptics,panel-coords:
    $ref: /schemas/types.yaml#/definitions/uint32-array
    description: Panel max X and Y coordinates in firmware units
    minItems: 2
    maxItems: 2

  synaptics,tx-rx-num:
    $ref: /schemas/types.yaml#/definitions/uint32-array
    description: TX and RX channel counts
    minItems: 2
    maxItems: 2

required:
  - compatible
  - reg
  - interrupts

unevaluatedProperties: false

...
```

## Documentation/devicetree/bindings/iommu/google,gs201-pcie-sysmmu.yaml
```yaml
# SPDX-License-Identifier: (GPL-2.0-only OR BSD-2-Clause)
%YAML 1.2
---
$id: http://devicetree.org/schemas/iommu/google,gs201-pcie-sysmmu.yaml#
$schema: http://devicetree.org/meta-schemas/core.yaml#

title: Google gs201 PCIe System MMU used as a DMA window

maintainers:
  - Derek Ross <derekross@gmail.com>

description:
  The Samsung System MMU (version 8.1) in front of the gs201 PCIe GEN4A_1
  controller. It is programmed with a 1:1 mapping of one reserved memory
  region, so the PCIe device can reach that region and nothing else.

properties:
  compatible:
    const: google,gs201-pcie-sysmmu

  reg:
    maxItems: 1

  interrupts:
    maxItems: 1

  clocks:
    maxItems: 2

  google,dma-window:
    $ref: /schemas/types.yaml#/definitions/phandle
    description:
      The reserved memory region (typically the PCIe device's
      restricted-dma-pool) that is the only memory the PCIe device may
      access. Not memory-region, which would make the pool this node's own
      DMA bounce buffer, placing the page table inside the window.

  google,vid:
    $ref: /schemas/types.yaml#/definitions/uint32
    maximum: 7
    default: 1
    description:
      The System MMU virtual ID translated by default (stock uses 1). No
      kernel code assigns the controller's VID, so this must be confirmed with
      a negative test.

required:
  - compatible
  - reg
  - interrupts
  - clocks

additionalProperties: false

examples:
  - |
    #include <dt-bindings/interrupt-controller/arm-gic.h>
    sysmmu@145c0000 {
        compatible = "google,gs201-pcie-sysmmu";
        reg = <0x145c0000 0x10000>;
        interrupts = <GIC_SPI 446 IRQ_TYPE_LEVEL_HIGH>;
        clocks = <&cmu_hsi2 17>, <&cmu_hsi2 55>;
        google,vid = <1>;
    };
```
