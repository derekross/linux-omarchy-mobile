## Documentation/devicetree/bindings/display/panel/samsung,ea8074.yaml
```yaml
# SPDX-License-Identifier: GPL-2.0-only OR BSD-2-Clause
%YAML 1.2
---
$id: http://devicetree.org/schemas/display/panel/samsung,ea8074.yaml#
$schema: http://devicetree.org/meta-schemas/core.yaml#

title: Samsung EA8074 AMOLED panel

maintainers:
  - quatrixone <quatrix1@gmail.com>

allOf:
  - $ref: panel-common.yaml#

properties:
  compatible:
    const: samsung,ea8074

  reg:
    maxItems: 1

  reset-gpios:
    maxItems: 1

  vci-supply:
    description: VCI regulator

  vddio-supply:
    description: VDDIO regulator

  port: true

required:
  - compatible
  - reg
  - reset-gpios
  - vci-supply
  - vddio-supply
  - port

unevaluatedProperties: false

examples:
  - |
    #include <dt-bindings/gpio/gpio.h>

    dsi {
        #address-cells = <1>;
        #size-cells = <0>;

        panel@0 {
            compatible = "samsung,ea8074";
            reg = <0>;
            reset-gpios = <&tlmm 6 GPIO_ACTIVE_LOW>;
            vci-supply = <&vreg_panel_vci>;
            vddio-supply = <&vreg_tp_vddio>;

            port {
                panel_in: endpoint {
                    remote-endpoint = <&dsi_out>;
                };
            };
        };
    };
```

## Documentation/devicetree/bindings/display/panel/samsung,s6e3fc5.yaml
```yaml
# SPDX-License-Identifier: GPL-2.0-only OR BSD-2-Clause
%YAML 1.2
---
$id: http://devicetree.org/schemas/display/panel/samsung,s6e3fc5.yaml#
$schema: http://devicetree.org/meta-schemas/core.yaml#

title: Samsung S6E3FC5 AMOLED DSI panel

description:
  The S6E3FC5 is a display driver IC from Samsung Mobile Display, driving
  the 1080x2400 command-mode AMOLED panel of the Google Pixel 7a. The panel
  takes DSC-compressed pixel data over four MIPI DSI lanes and reports its
  refresh timing on a tearing effect (TE) line.

maintainers:
  - Derek Ross <derekross@gmail.com>

allOf:
  - $ref: panel-common.yaml#

properties:
  compatible:
    const: samsung,s6e3fc5

  reg:
    maxItems: 1

  reset-gpios: true

  vddio-supply:
    description: I/O supply

  avdd-supply:
    description: Analog supply

required:
  - compatible
  - reg
  - reset-gpios

unevaluatedProperties: false

examples:
  - |
    #include <dt-bindings/gpio/gpio.h>

    dsi {
        #address-cells = <1>;
        #size-cells = <0>;

        panel@0 {
            compatible = "samsung,s6e3fc5";
            reg = <0>;
            reset-gpios = <&gpp23 2 GPIO_ACTIVE_LOW>;
            vddio-supply = <&ldo25m>;
            avdd-supply = <&ldo26m>;
            width-mm = <70>;
            height-mm = <149>;
        };
    };

...
```

## Documentation/devicetree/bindings/display/panel/samsung,s6e3hc4.yaml
```yaml
# SPDX-License-Identifier: GPL-2.0-only OR BSD-2-Clause
%YAML 1.2
---
$id: http://devicetree.org/schemas/display/panel/samsung,s6e3hc4.yaml#
$schema: http://devicetree.org/meta-schemas/core.yaml#

title: Samsung S6E3HC4 AMOLED DSI panel

description:
  The S6E3HC4 is a display driver IC from Samsung Mobile Display, driving
  the 1440x3120 command-mode AMOLED panel of the Google Pixel 7 Pro. The
  panel takes DSC-compressed pixel data over four MIPI DSI lanes and
  reports its refresh timing on a tearing effect (TE) line.

maintainers:
  - Derek Ross <derekross@gmail.com>

allOf:
  - $ref: panel-common.yaml#

properties:
  compatible:
    enum:
      - samsung,s6e3hc3
      - samsung,s6e3hc4

  reg:
    maxItems: 1

  reset-gpios: true

  vddi-supply:
    description: I/O supply (1.8 V)

  vddd-supply:
    description: Digital core supply (1.125 V)

  vci-supply:
    description: Analog supply (3.0 V)

required:
  - compatible
  - reg

if:
  properties:
    compatible:
      contains:
        const: samsung,s6e3hc4
then:
  required:
    - reset-gpios

unevaluatedProperties: false

examples:
  - |
    #include <dt-bindings/gpio/gpio.h>

    dsi {
        #address-cells = <1>;
        #size-cells = <0>;

        panel@0 {
            compatible = "samsung,s6e3hc4";
            reg = <0>;
            reset-gpios = <&gpa7 1 GPIO_ACTIVE_LOW>;
            vddi-supply = <&vddi>;
            vddd-supply = <&vddd>;
            vci-supply = <&vci>;
            width-mm = <71>;
            height-mm = <155>;
        };
    };

...
```

## Documentation/devicetree/bindings/display/samsung/google,gs201-decon.yaml
```yaml
# SPDX-License-Identifier: GPL-2.0-only OR BSD-2-Clause
%YAML 1.2
---
$id: http://devicetree.org/schemas/display/samsung/google,gs201-decon.yaml#
$schema: http://devicetree.org/meta-schemas/core.yaml#

title: Google Tensor display controller (DECON)

maintainers:
  - Derek Ross <derekross@gmail.com>

description:
  The DECON is the display controller of the gs201 (Tensor G2) and zumapro
  (Tensor G4) display pipelines. It blends up to six or fourteen windows,
  respectively, each fed by a DPP read DMA
  channel, compresses the result with DSC and hands it to a DSIM. In
  command mode a frame is sent on each tearing effect (TE) pulse of the
  panel; register writes are double-buffered and take effect at the
  next frame start after a shadow update request.

properties:
  compatible:
    enum:
      - google,gs201-decon
      - google,zumapro-decon

  reg:
    items:
      - description: DECON main registers
      - description: DPP0 read DMA registers

  reg-names:
    items:
      - const: main
      - const: dma

  interrupts:
    items:
      - description: frame start
      - description: frame done
      - description: extra (errors, TE edges)

  interrupt-names:
    items:
      - const: frame_start
      - const: frame_done
      - const: extra

  memory-region:
    items:
      - description: contiguous pool for scanout buffers, below 4 GiB
      - description: the framebuffer the bootloader scans out

  memory-region-names:
    items:
      - const: pool
      - const: boot-framebuffer

  clocks:
    items:
      - description: memory interface (MIF) DVFS domain
      - description: display (DISP) DVFS domain

  clock-names:
    items:
      - const: mif
      - const: disp

  power-domains:
    maxItems: 1

  port:
    $ref: /schemas/graph.yaml#/properties/port
    description:
      Output to the DSIM, which switches the panel's refresh rate.

required:
  - compatible
  - reg
  - reg-names
  - interrupts
  - interrupt-names

additionalProperties: false

examples:
  - |
    #include <dt-bindings/interrupt-controller/arm-gic.h>

    display-controller@1c240000 {
        compatible = "google,gs201-decon";
        reg = <0x1c240000 0x6000>, <0x1c0b0000 0x1000>;
        reg-names = "main", "dma";
        interrupts = <GIC_SPI 241 IRQ_TYPE_LEVEL_HIGH>,
                     <GIC_SPI 240 IRQ_TYPE_LEVEL_HIGH>,
                     <GIC_SPI 239 IRQ_TYPE_LEVEL_HIGH>;
        interrupt-names = "frame_start", "frame_done", "extra";

        port {
            decon0_out: endpoint {
                remote-endpoint = <&dsi0_in>;
            };
        };
    };

...
```

## Documentation/devicetree/bindings/display/samsung/google,gs201-dsim.yaml
```yaml
# SPDX-License-Identifier: GPL-2.0-only OR BSD-2-Clause
%YAML 1.2
---
$id: http://devicetree.org/schemas/display/samsung/google,gs201-dsim.yaml#
$schema: http://devicetree.org/meta-schemas/core.yaml#

title: Google gs201 MIPI DSI master (DSIM)

maintainers:
  - Derek Ross <derekross@gmail.com>

description:
  The DSIM is the MIPI DSI master of the gs201 (Tensor G2) display
  pipeline. It takes pixel data from a DECON and drives up to four data
  lanes through a combined D-PHY/C-PHY, in video or command mode, with
  DSC slice packing and TE-based command scheduling. Panels are described
  as child nodes.

allOf:
  - $ref: /schemas/display/dsi-controller.yaml#

properties:
  compatible:
    oneOf:
      - const: google,gs201-dsim
      - items:
          - enum:
              - google,gs101-dsim
          - const: google,gs201-dsim

  reg:
    minItems: 1
    items:
      - description: DSIM link registers
      - description: D-PHY lane registers
      - description: D-PHY common registers

  reg-names:
    minItems: 1
    items:
      - const: dsi
      - const: dphy
      - const: dphy-extra

  interrupts:
    maxItems: 1

  power-domains:
    maxItems: 1

  port:
    $ref: /schemas/graph.yaml#/properties/port
    description:
      Input from the DECON.

required:
  - compatible
  - reg
  - interrupts

unevaluatedProperties: false

examples:
  - |
    #include <dt-bindings/interrupt-controller/arm-gic.h>
    #include <dt-bindings/gpio/gpio.h>

    dsi@1c2c0000 {
        compatible = "google,gs201-dsim";
        reg = <0x1c2c0000 0x300>, <0x1c2e0100 0x700>, <0x1c2e0000 0x100>;
        reg-names = "dsi", "dphy", "dphy-extra";
        interrupts = <GIC_SPI 250 IRQ_TYPE_LEVEL_HIGH>;
        #address-cells = <1>;
        #size-cells = <0>;

        port {
            dsi0_in: endpoint {
                remote-endpoint = <&decon0_out>;
            };
        };

        panel@0 {
            compatible = "samsung,s6e3hc4";
            reg = <0>;
            reset-gpios = <&gpa7 1 GPIO_ACTIVE_LOW>;
        };
    };

...
```

## Documentation/devicetree/bindings/firmware/android,trusty-smc-v1.yaml
```yaml
# SPDX-License-Identifier: (GPL-2.0-only OR BSD-2-Clause)
%YAML 1.2
---
$id: http://devicetree.org/schemas/firmware/android,trusty-smc-v1.yaml#
$schema: http://devicetree.org/meta-schemas/core.yaml#

title: Trusty secure OS

maintainers:
  - Derek Ross <derekross@gmail.com>

description:
  Trusty is a secure OS that runs alongside Linux in the secure world and is
  reached through SMC calls. The node describes the interface to an already
  running Trusty; its children are the services that ride on it.

properties:
  compatible:
    const: android,trusty-smc-v1

  irq:
    type: object
    additionalProperties: false
    description:
      Forwarding of the interrupts Trusty asks for. Trusty reports the
      interrupt numbers it uses; those in ipi-range are inter-processor
      interrupts, mapped onto GIC SGIs.
    properties:
      compatible:
        const: android,trusty-irq-v1
      ipi-range:
        $ref: /schemas/types.yaml#/definitions/uint32-array
        description:
          First and last Trusty IPI number, and the GIC SGI the first one
          maps to.
        items:
          - description: first Trusty IPI number
          - description: last Trusty IPI number
          - description: GIC SGI of the first one
    required:
      - compatible

  log:
    type: object
    additionalProperties: false
    description: Trusty's log, copied into the kernel log.
    properties:
      compatible:
        const: android,trusty-log-v1
    required:
      - compatible

  virtio:
    type: object
    additionalProperties: false
    description:
      The virtio devices Trusty exposes, among them the IPC device used to
      reach trusted applications.
    properties:
      compatible:
        const: android,trusty-virtio-v1
    required:
      - compatible

required:
  - compatible

additionalProperties: false

examples:
  - |
    trusty {
        compatible = "android,trusty-smc-v1";

        irq {
            compatible = "android,trusty-irq-v1";
            ipi-range = <8 15 8>;
        };

        log {
            compatible = "android,trusty-log-v1";
        };

        virtio {
            compatible = "android,trusty-virtio-v1";
        };
    };
```
