## Documentation/devicetree/bindings/arm/google.yaml
```yaml
# SPDX-License-Identifier: GPL-2.0-only OR BSD-2-Clause
%YAML 1.2
---
$id: http://devicetree.org/schemas/arm/google.yaml#
$schema: http://devicetree.org/meta-schemas/core.yaml#

title: Google Tensor platforms

maintainers:
  - Peter Griffin <peter.griffin@linaro.org>

description: |
  ARM platforms using SoCs designed by Google branded "Tensor" used in Pixel
  devices.

  Currently upstream this is devices using "gs101" SoC which is found in Pixel
  6, Pixel 6 Pro and Pixel 6a.

  Google have a few different names for the SoC:
  - Marketing name ("Tensor")
  - Codename ("Whitechapel")
  - SoC ID ("gs101")
  - Die ID ("S5P9845")

  Likewise there are a couple of names for the actual device
  - Marketing name ("Pixel 6")
  - Codename ("Oriole")

  Devicetrees should use the lowercased SoC ID and lowercased board codename,
  e.g. gs101 and gs101-oriole.

properties:
  $nodename:
    const: '/'
  compatible:
    oneOf:
      - description: Google Pixel 6 or 6 Pro (Oriole or Raven)
        items:
          - enum:
              - google,gs101-oriole
              - google,gs101-raven
          - const: google,gs101
      - description: Google Tensor G2 (GS201) boards
        items:
          - enum:
              - google,gs201-cheetah
              - google,gs201-felix
              - google,gs201-lynx
          - const: google,gs201
      - description: Google Tensor G3 (zuma) boards
        items:
          - enum:
              - google,zuma-husky
          - const: google,zuma

  # Bootloader requires an ect node to be present: empty on gs101 and gs201,
  # with the location of the ECT blob on zuma
  ect:
    type: object
    additionalProperties: false
    properties:
      parameter_address:
        $ref: /schemas/types.yaml#/definitions/uint32
        description:
          Physical address of the Exynos Characteristic Table (ECT), the
          bootloader-provided table of clock, voltage and timing parameters.
      parameter_size:
        $ref: /schemas/types.yaml#/definitions/uint32
        description: Size of the ECT in bytes.

  soc_compatible:
    type: object
    description:
      Bootloaders that match on this node rather than /soc_id (zuma's, and
      the Pixel 7a's) pick the base DTB by matching the SoC's product id,
      revision and package against these children, one per supported
      silicon revision and package.
    additionalProperties:
      type: object
      # Stock trees also give each child a human-readable label in a
      # property named "description", which a schema cannot name.
      additionalProperties: true
      properties:
        product_id:
          $ref: /schemas/types.yaml#/definitions/uint32
        major:
          $ref: /schemas/types.yaml#/definitions/uint32
        minor:
          $ref: /schemas/types.yaml#/definitions/uint32
        pkg_mode:
          $ref: /schemas/types.yaml#/definitions/uint32
      required:
        - product_id
        - major
        - minor
        - pkg_mode

required:
  - ect

allOf:
  - if:
      properties:
        compatible:
          not:
            contains:
              const: google,zuma
    then:
      properties:
        ect:
          properties:
            parameter_address: false
            parameter_size: false

additionalProperties: true

...
```

## Documentation/devicetree/bindings/clock/google,zuma-clock.yaml
```yaml
# SPDX-License-Identifier: (GPL-2.0-only OR BSD-2-Clause)
%YAML 1.2
---
$id: http://devicetree.org/schemas/clock/google,zuma-clock.yaml#
$schema: http://devicetree.org/meta-schemas/core.yaml#

title: Google Tensor G3 clock controllers

maintainers:
  - Brett-Michael Green <brett@bmgvisualtech.com>

description: |
  CMU_TOP supplies the HSI0 NoC and peripheral clocks to CMU_HSI0 from its
  shared PLLs. CMU_HSI0 supplies USI2, the touchscreen's SPI, from the HSI0
  peripheral clock; its NoC path also takes the board-level HSI0 ALT clock.
  CMU_APM supplies the APM mailbox, its internal memory and the always-on
  GPIO banks from the always-on ALV PLL and the oscillator.
  The external oscillator supplies the PLL reference and the oscillator mux
  paths.
  Clock identifiers are defined in dt-bindings/clock/google,zuma.h.

properties:
  compatible:
    enum:
      - google,zuma-cmu-top
      - google,zuma-cmu-apm
      - google,zuma-cmu-hsi0

  reg:
    maxItems: 1

  "#clock-cells":
    const: 1

  clocks:
    minItems: 1
    maxItems: 4

  clock-names:
    minItems: 1
    maxItems: 4

required:
  - compatible
  - reg
  - "#clock-cells"
  - clocks
  - clock-names

allOf:
  - if:
      properties:
        compatible:
          enum:
            - google,zuma-cmu-top
            - google,zuma-cmu-apm
    then:
      properties:
        clocks:
          items:
            - description: External oscillator reference clock
        clock-names:
          items:
            - const: oscclk
  - if:
      properties:
        compatible:
          const: google,zuma-cmu-hsi0
    then:
      properties:
        clocks:
          items:
            - description: External oscillator reference clock
            - description: HSI0 NoC clock from CMU_TOP
            - description: HSI0 peripheral clock from CMU_TOP
            - description: HSI0 ALT input clock
        clock-names:
          items:
            - const: oscclk
            - const: bus
            - const: peri
            - const: alt

additionalProperties: false

examples:
  - |
    #include <dt-bindings/clock/google,zuma.h>

    cmu_top: clock-controller@26040000 {
        compatible = "google,zuma-cmu-top";
        reg = <0x26040000 0x8000>;
        #clock-cells = <1>;
        clocks = <&oscclk>;
        clock-names = "oscclk";
    };

    clock-controller@11000000 {
        compatible = "google,zuma-cmu-hsi0";
        reg = <0x11000000 0x8000>;
        #clock-cells = <1>;
        clocks = <&oscclk>, <&cmu_top CLK_DOUT_HSI0_NOC>,
                 <&cmu_top CLK_DOUT_HSI0_PERI>, <&hsi0_alt>;
        clock-names = "oscclk", "bus", "peri", "alt";
    };

...
```

## Documentation/devicetree/bindings/clock/google,zumapro-clock.yaml
```yaml
# SPDX-License-Identifier: (GPL-2.0-only OR BSD-2-Clause)
%YAML 1.2
---
$id: http://devicetree.org/schemas/clock/google,zumapro-clock.yaml#
$schema: http://devicetree.org/meta-schemas/core.yaml#

title: Google Tensor G4 clock controllers

maintainers:
  - W4HO <87742609+W4HO-ham@users.noreply.github.com>

description: |
  CMU_TOP supplies the NoC and UFS clock paths to CMU_HSI2 and the supply-GPIO
  path in CMU_PERIC0. CMU_TOP also provides the HSI0 parent rate paths.
  CMU_MISC supplies the firmware-owned watchdog bus clock paths.
  The external oscillator supplies the PLL reference and oscillator mux
  paths.
  Clock identifiers are defined in dt-bindings/clock/google,zumapro.h.

properties:
  compatible:
    enum:
      - google,zumapro-cmu-top
      - google,zumapro-cmu-hsi2
      - google,zumapro-cmu-peric0
      - google,zumapro-cmu-misc

  reg:
    maxItems: 1

  "#clock-cells":
    const: 1

  clocks:
    minItems: 1
    maxItems: 4

  clock-names:
    minItems: 1
    maxItems: 4

required:
  - compatible
  - reg
  - "#clock-cells"
  - clocks
  - clock-names

allOf:
  - if:
      properties:
        compatible:
          const: google,zumapro-cmu-top
    then:
      properties:
        clocks:
          items:
            - description: External oscillator reference clock
        clock-names:
          items:
            - const: oscclk
  - if:
      properties:
        compatible:
          const: google,zumapro-cmu-hsi2
    then:
      properties:
        clocks:
          items:
            - description: HSI2 oscillator clock
            - description: HSI2 NoC clock from CMU_TOP
            - description: HSI2 UFS clock from CMU_TOP
            - description: HSI2 PCIe clock from CMU_TOP
        clock-names:
          items:
            - const: oscclk
            - const: bus
            - const: ufs
            - const: pcie
  - if:
      properties:
        compatible:
          enum:
            - google,zumapro-cmu-peric0
            - google,zumapro-cmu-misc
    then:
      properties:
        clocks:
          items:
            - description: Domain oscillator reference clock
            - description: Domain NoC clock from CMU_TOP
        clock-names:
          items:
            - const: oscclk
            - const: bus

additionalProperties: false

examples:
  - |
    #include <dt-bindings/clock/google,zumapro.h>

    cmu_top: clock-controller@26040000 {
        compatible = "google,zumapro-cmu-top";
        reg = <0x26040000 0x8000>;
        #clock-cells = <1>;
        clocks = <&oscclk>;
        clock-names = "oscclk";
    };

    clock-controller@13000000 {
        compatible = "google,zumapro-cmu-hsi2";
        reg = <0x13000000 0x8000>;
        #clock-cells = <1>;
        clocks = <&oscclk>, <&cmu_top CLK_DOUT_HSI2_NOC>,
                 <&cmu_top CLK_DOUT_HSI2_UFS>,
                 <&cmu_top CLK_DOUT_HSI2_PCIE>;
        clock-names = "oscclk", "bus", "ufs", "pcie";
    };

    clock-controller@10010000 {
        compatible = "google,zumapro-cmu-misc";
        reg = <0x10010000 0x8000>;
        #clock-cells = <1>;
        clocks = <&oscclk>, <&cmu_top CLK_DOUT_MISC_NOC>;
        clock-names = "oscclk", "bus";
    };

    clock-controller@10800000 {
        compatible = "google,zumapro-cmu-peric0";
        reg = <0x10800000 0x8000>;
        #clock-cells = <1>;
        clocks = <&oscclk>, <&cmu_top CLK_DOUT_PERIC0_NOC>;
        clock-names = "oscclk", "bus";
    };
...
```

## Documentation/devicetree/bindings/clock/google,zumapro-hsi0-clock.yaml
```yaml
# SPDX-License-Identifier: GPL-2.0-only OR BSD-2-Clause
%YAML 1.2
---
$id: http://devicetree.org/schemas/clock/google,zumapro-hsi0-clock.yaml#
$schema: http://devicetree.org/meta-schemas/core.yaml#

title: Google Tensor G4 HSI0 clock controller

maintainers:
  - W4HO <87742609+W4HO-ham@users.noreply.github.com>

description: |
  CMU_HSI0 provides clocks for USB and the HSI0 USI interfaces. Its local
  bus mux can select the TOP NoC clock or a separate alternate input. The
  USB reference mux selects the local USB PLL divider or the TCXO user mux.
  Firmware leaves HSI0 powered at handoff and Linux does not power it off.
  Power-off, suspend and S2MPU context restoration are not qualified.
  Clock identifiers are defined in dt-bindings/clock/google,zumapro.h.

properties:
  compatible:
    const: google,zumapro-cmu-hsi0

  reg:
    maxItems: 1

  clocks:
    items:
      - description: OSCCLK_HSI0 oscillator reference
      - description: TOP CLKCMU_HSI0_NOC input
      - description: TOP CLKCMU_HSI0_PERI input
      - description: Separate I_CLK_HSI0_ALT input
      - description: TCXO_HSI1_HSI0 input

  clock-names:
    items:
      - const: oscclk
      - const: noc
      - const: peri
      - const: alt
      - const: tcxo

  "#clock-cells":
    const: 1

  power-domains: false

required:
  - compatible
  - reg
  - clocks
  - clock-names
  - "#clock-cells"

additionalProperties: false

examples:
  - |
    #include <dt-bindings/clock/google,zumapro.h>

    clock-controller@11000000 {
        compatible = "google,zumapro-cmu-hsi0";
        reg = <0x11000000 0x8000>;
        clocks = <&oscclk>, <&cmu_top CLK_DOUT_HSI0_NOC>,
                 <&cmu_top CLK_DOUT_HSI0_PERI>, <&hsi0_alt>, <&hsi0_tcxo>;
        clock-names = "oscclk", "noc", "peri", "alt", "tcxo";
        #clock-cells = <1>;
    };
```

## Documentation/devicetree/bindings/display/panel/boe,nt37290.yaml
```yaml
# SPDX-License-Identifier: GPL-2.0-only OR BSD-2-Clause
%YAML 1.2
---
$id: http://devicetree.org/schemas/display/panel/boe,nt37290.yaml#
$schema: http://devicetree.org/meta-schemas/core.yaml#

title: BOE NT37290 AMOLED DSI panel

description:
  The NT37290 is a display driver IC from BOE Technology Group, driving
  the 1440x3120 command-mode AMOLED panel of BOE-variant Google Pixel 7
  Pro units. The panel takes DSC-compressed pixel data over four MIPI
  DSI lanes and reports its refresh timing on a tearing effect (TE)
  line. The panel variant on a given device is named by the bootloader
  on the kernel command line.

maintainers:
  - Derek Ross <derekross@gmail.com>

allOf:
  - $ref: panel-common.yaml#

properties:
  compatible:
    const: boe,nt37290

  reg:
    maxItems: 1

  reset-gpios: true

  vddi-supply:
    description: I/O supply (1.8 V)

  vddd-supply:
    description: Digital core supply (1.125 V)

  vci-supply:
    description: Analog supply (3.0 V)

required:
  - compatible
  - reg
  - reset-gpios

unevaluatedProperties: false

examples:
  - |
    #include <dt-bindings/gpio/gpio.h>

    dsi {
        #address-cells = <1>;
        #size-cells = <0>;

        panel@0 {
            compatible = "boe,nt37290";
            reg = <0>;
            reset-gpios = <&gpa7 1 GPIO_ACTIVE_LOW>;
            vddi-supply = <&vddi>;
            vddd-supply = <&vddd>;
            vci-supply = <&vci>;
            width-mm = <71>;
            height-mm = <155>;
        };
    };

...
```

## Documentation/devicetree/bindings/display/panel/google,hk3.yaml
```yaml
# SPDX-License-Identifier: GPL-2.0-only OR BSD-2-Clause
%YAML 1.2
---
$id: http://devicetree.org/schemas/display/panel/google,hk3.yaml#
$schema: http://devicetree.org/meta-schemas/core.yaml#

title: Google HK3 AMOLED DSI panel

description:
  The HK3 is the 1344x2992 command-mode AMOLED panel of the Google Pixel
  8 Pro. It takes DSC 1.2 compressed pixel data (two 672x187 slices at 8
  bits per pixel) over four MIPI DSI lanes, reports its refresh timing on
  a tearing effect (TE) line and runs at 60 or 120 Hz.

maintainers:
  - Brett-Michael Green <brett@bmgvisualtech.com>

allOf:
  - $ref: panel-common.yaml#

properties:
  compatible:
    const: google,hk3

  reg:
    maxItems: 1

  reset-gpios: true

  vddi-supply:
    description: I/O supply

  vddd-supply:
    description: Digital core supply

  vci-supply:
    description: Analog supply

required:
  - compatible
  - reg

unevaluatedProperties: false

examples:
  - |
    #include <dt-bindings/gpio/gpio.h>

    dsi {
        #address-cells = <1>;
        #size-cells = <0>;

        panel@0 {
            compatible = "google,hk3";
            reg = <0>;
            reset-gpios = <&gpp0 0 GPIO_ACTIVE_LOW>;
            vci-supply = <&vci>;
            vddi-supply = <&vddi>;
            vddd-supply = <&vddd>;
        };
    };

...
```

## Documentation/devicetree/bindings/display/panel/oneplus,dodge-panel.yaml
```yaml
# SPDX-License-Identifier: (GPL-2.0-only OR BSD-2-Clause)
%YAML 1.2
---
$id: http://devicetree.org/schemas/display/panel/oneplus,dodge-panel.yaml#
$schema: http://devicetree.org/meta-schemas/core.yaml#

title: OnePlus 13 (dodge) DSC panel

maintainers:
  - Martin Lund <mrlund@hotmail.com>

description:
  DSC panel used on the OnePlus 13 (dodge), driven by
  drivers/gpu/drm/panel/panel-aa569-p-3-a0019-dsc.c.

allOf:
  - $ref: panel-common.yaml#

properties:
  compatible:
    const: oneplus,dodge-panel

  reg:
    maxItems: 1

  vddio-supply: true
  vci-supply: true
  vdd-supply: true
  reset-gpios: true
  port: true

required:
  - compatible
  - reg
  - reset-gpios

unevaluatedProperties: false

...
```
