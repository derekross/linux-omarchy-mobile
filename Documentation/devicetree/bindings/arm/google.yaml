## Documentation/devicetree/bindings/firmware/google,gs101-acpm-ipc.yaml
```yaml
# SPDX-License-Identifier: (GPL-2.0-only OR BSD-2-Clause)
# Copyright 2024 Linaro Ltd.
%YAML 1.2
---
$id: http://devicetree.org/schemas/firmware/google,gs101-acpm-ipc.yaml#
$schema: http://devicetree.org/meta-schemas/core.yaml#

title: Samsung Exynos ACPM mailbox protocol

maintainers:
  - Tudor Ambarus <tudor.ambarus@linaro.org>

description: |
  ACPM (Alive Clock and Power Manager) is a firmware that operates on the
  APM (Active Power Management) module that handles overall power management
  activities. ACPM and masters regard each other as independent hardware
  component and communicate with each other using mailbox messages and
  shared memory.

  This binding is intended to define the interface the firmware implementing
  ACPM provides for OSPM in the device tree.

properties:
  compatible:
    enum:
      - google,gs101-acpm-ipc
      - google,gs201-acpm-ipc
      - google,zuma-acpm-ipc
      - google,zumapro-acpm-ipc

  "#clock-cells":
    const: 1
    description:
      Clocks that are variable and index based. These clocks don't provide
      an entire range of values between the limits but only discrete points
      within the range. The firmware also manages the voltage scaling
      appropriately with the clock scaling. The argument is the ID of the
      clock contained by the firmware messages.

  assigned-clocks:
    description:
      Firmware clocks to set at boot, for a board whose bootloader leaves
      a domain at a rate nothing else scales yet.

  assigned-clock-rates: true

  mboxes:
    maxItems: 1

  pmic:
    deprecated: true
    description: Child node describing the main PMIC.
    type: object
    additionalProperties: true

    properties:
      compatible:
        const: samsung,s2mpg10-pmic

  pmic-1:
    description: Child node describing the main PMIC.
    type: object
    additionalProperties: true

    properties:
      compatible:
        enum:
          - samsung,s2mpg10-pmic
          - samsung,s2mpg12-pmic
          - samsung,s2mpg14-pmic

  pmic-2:
    description: Child node describing the sub PMIC.
    type: object
    additionalProperties: true

  thermal-sensor:
    description:
      The SoC's thermal sensors, which the ACPM firmware reads on the
      kernel's behalf. Cells are the sensor index (0 big, 1 mid, 2 little
      CPU cluster, 3 GPU, 4 ISP, 5 TPU, and on zumapro 6 AUR).
    type: object
    $ref: /schemas/thermal/thermal-sensor.yaml#
    unevaluatedProperties: false

    properties:
      compatible:
        enum:
          - google,gs101-acpm-tmu
          - google,zumapro-acpm-tmu

      "#thermal-sensor-cells":
        const: 1

    required:
      - compatible

  shmem:
    description:
      List of phandle pointing to the shared memory (SHM) area. The memory
      contains channels configuration data and the TX/RX ring buffers that
      are used for passing messages to/from the ACPM firmware.
    maxItems: 1

required:
  - compatible
  - "#clock-cells"
  - mboxes
  - shmem

allOf:
  - if:
      properties:
        compatible:
          enum:
            - google,zuma-acpm-ipc
            - google,zumapro-acpm-ipc
    then:
      properties:
        pmic: false
        pmic-1:
          properties:
            compatible:
              const: samsung,s2mpg14-pmic
  - if:
      properties:
        compatible:
          const: google,gs201-acpm-ipc
    then:
      properties:
        pmic: false
        pmic-1:
          properties:
            compatible:
              const: samsung,s2mpg12-pmic
        pmic-2:
          properties:
            compatible:
              const: samsung,s2mpg13-pmic
  - if:
      properties:
        compatible:
          const: google,gs101-acpm-ipc
    then:
      properties:
        pmic-1:
          properties:
            compatible:
              const: samsung,s2mpg10-pmic
        pmic-2:
          properties:
            compatible:
              const: samsung,s2mpg11-pmic

additionalProperties: false

examples:
  - |
    #include <dt-bindings/gpio/gpio.h>
    #include <dt-bindings/interrupt-controller/irq.h>
    #include <dt-bindings/regulator/samsung,s2mpg10-regulator.h>

    power-management {
        compatible = "google,gs101-acpm-ipc";
        #clock-cells = <1>;
        mboxes = <&ap2apm_mailbox>;
        shmem = <&apm_sram>;

        pmic-1 {
            compatible = "samsung,s2mpg10-pmic";
            interrupts-extended = <&gpa0 6 IRQ_TYPE_LEVEL_LOW>;

            vinl3m-supply = <&buck8m>;

            regulators {
                ldo1m {
                    regulator-name = "vdd_ldo1";
                    regulator-min-microvolt = <700000>;
                    regulator-max-microvolt = <1300000>;
                    regulator-always-on;
                };

                ldo20m {
                    regulator-name = "vdd_dmics";
                    regulator-min-microvolt = <700000>;
                    regulator-max-microvolt = <1300000>;
                    regulator-always-on;
                    samsung,ext-control = <S2MPG10_EXTCTRL_LDO20M_EN2>;
                };

                buck8m {
                    regulator-name = "vdd_mif";
                    regulator-min-microvolt = <450000>;
                    regulator-max-microvolt = <1300000>;
                    regulator-always-on;
                    regulator-boot-on;
                };
            };
        };

        pmic-2 {
            compatible = "samsung,s2mpg11-pmic";
            interrupts-extended = <&gpa0 7 IRQ_TYPE_LEVEL_LOW>;

            vinl1s-supply = <&buck8m>;
            vinl2s-supply = <&buck6s>;

            regulators {
                buckd {
                    regulator-name = "vcc_ufs";
                    regulator-ramp-delay = <6250>;
                    enable-gpios = <&gpp0 1 GPIO_ACTIVE_HIGH>;
                    samsung,ext-control = <S2MPG11_EXTCTRL_UFS_EN>;
                };
            };
        };
    };
```

## Documentation/devicetree/bindings/gnss/brcm,bcm4775-gnss.yaml
```yaml
# SPDX-License-Identifier: (GPL-2.0-only OR BSD-2-Clause)
%YAML 1.2
---
$id: http://devicetree.org/schemas/gnss/brcm,bcm4775-gnss.yaml#
$schema: http://devicetree.org/meta-schemas/core.yaml#

title: Broadcom BCM4775x GNSS receiver on SPI

maintainers:
  - Derek Ross <derekross@gmail.com>

description: |
  The Broadcom BCM4775x family of GNSS receivers (BCM4775, BCM4776, ...) as
  used in Google's Pixel 7 phones. The host talks to it over SPI with
  Broadcom's SSI framing. Besides the bus, the chip has a standby line, a
  request/response pair for waking its MCU, and a "host request" line it
  raises when it has data.

allOf:
  - $ref: /schemas/spi/spi-peripheral-props.yaml#

properties:
  compatible:
    const: brcm,bcm4775-gnss

  reg:
    maxItems: 1

  spi-max-frequency: true
  spi-cpol: true
  spi-cpha: true

  interrupts:
    maxItems: 1
    description: The host request line, level high.

  nstandby-gpios:
    maxItems: 1
    description: Standby control; the chip runs while the line is high.

  mcu-req-gpios:
    maxItems: 1
    description: Host to chip wake request.

  mcu-resp-gpios:
    maxItems: 1
    description: Chip to host answer to the wake request.

  host-req-gpios:
    maxItems: 1
    description: Chip to host data request (also the interrupt).

  vddcore-supply:
    description: Digital core supply.

  vddrf-supply:
    description: RF supply.

  vddaux-supply:
    description: Auxiliary (I/O) supply.

required:
  - compatible
  - reg
  - nstandby-gpios
  - mcu-req-gpios
  - mcu-resp-gpios
  - host-req-gpios
  - vddcore-supply
  - vddrf-supply
  - vddaux-supply

unevaluatedProperties: false

examples:
  - |
    #include <dt-bindings/gpio/gpio.h>
    #include <dt-bindings/interrupt-controller/irq.h>

    spi {
        #address-cells = <1>;
        #size-cells = <0>;

        gnss@0 {
            compatible = "brcm,bcm4775-gnss";
            reg = <0>;
            spi-max-frequency = <26000000>;
            spi-cpol;
            spi-cpha;
            interrupts-extended = <&gpa6 4 IRQ_TYPE_LEVEL_HIGH>;
            nstandby-gpios = <&gph2 3 GPIO_ACTIVE_HIGH>;
            mcu-req-gpios = <&gpp4 3 GPIO_ACTIVE_HIGH>;
            mcu-resp-gpios = <&gph2 2 GPIO_ACTIVE_HIGH>;
            host-req-gpios = <&gpa6 4 GPIO_ACTIVE_HIGH>;
            vddcore-supply = <&ldo9s>;
            vddrf-supply = <&ldo10s>;
            vddaux-supply = <&ldo11s>;
        };
    };
```

## Documentation/devicetree/bindings/gnss/samsung,exynos-gnss.yaml
```yaml
# SPDX-License-Identifier: (GPL-2.0-only OR BSD-2-Clause)
%YAML 1.2
---
$id: http://devicetree.org/schemas/gnss/samsung,exynos-gnss.yaml#
$schema: http://devicetree.org/meta-schemas/core.yaml#

title: Samsung Kepler GNSS core, handshake lines

maintainers:
  - W4HO <87742609+W4HO-ham@users.noreply.github.com>

description: |
  The control side of the Kepler GNSS core's SPI link (samsung,gnss-spi):
  two lines between the core and the host that pace the transfers. The
  core raises its line while it has data for the host, and to answer the
  host's request to write. The host raises its line to ask to write, and
  pulses it to acknowledge the core's request before reading. The node has
  no registers, clocks or supplies of its own.

properties:
  compatible:
    const: samsung,exynos-gnss

  gnss2ap-spi-gpios:
    maxItems: 1
    description:
      Core to host request line, active high. It is also the host's
      interrupt, so its GPIO controller must be able to raise one.

  ap2gnss-spi-gpios:
    maxItems: 1
    description:
      Host to core request line, active high. Low when the host is idle.

required:
  - compatible
  - gnss2ap-spi-gpios
  - ap2gnss-spi-gpios

additionalProperties: false

examples:
  - |
    #include <dt-bindings/gpio/gpio.h>

    gnss {
        compatible = "samsung,exynos-gnss";
        gnss2ap-spi-gpios = <&gpa5 4 GPIO_ACTIVE_HIGH>;
        ap2gnss-spi-gpios = <&gpp2 3 GPIO_ACTIVE_HIGH>;
    };
```

## Documentation/devicetree/bindings/gnss/samsung,gnss-spi.yaml
```yaml
# SPDX-License-Identifier: (GPL-2.0-only OR BSD-2-Clause)
%YAML 1.2
---
$id: http://devicetree.org/schemas/gnss/samsung,gnss-spi.yaml#
$schema: http://devicetree.org/meta-schemas/core.yaml#

title: Samsung Kepler GNSS core, SPI data link

maintainers:
  - W4HO <87742609+W4HO-ham@users.noreply.github.com>

description: |
  Samsung's Kepler GNSS core is part of the S5300 modem in the Google
  Pixel 9a. It runs firmware that the host loads into the modem's shared
  memory, and it exchanges its data with the host over an SPI bus of the
  application processor (USI3 of HSI0 on Tensor G4), in blocks of 64
  bytes. The core and its supplies belong to the modem; this node is only
  the SPI device. The two lines that pace the transfers are described by
  a samsung,exynos-gnss node.

allOf:
  - $ref: /schemas/spi/spi-peripheral-props.yaml#

properties:
  compatible:
    const: samsung,gnss-spi

  reg:
    maxItems: 1

required:
  - compatible
  - reg

unevaluatedProperties: false

examples:
  - |
    spi {
        #address-cells = <1>;
        #size-cells = <0>;

        gnss@0 {
            compatible = "samsung,gnss-spi";
            reg = <0>;
            spi-max-frequency = <3125000>;

            controller-data {
                samsung,spi-feedback-delay = <0>;
            };
        };
    };
```

## Documentation/devicetree/bindings/gpio/maxim,max77779-pmic.yaml
```yaml
# SPDX-License-Identifier: (GPL-2.0-only OR BSD-2-Clause)
%YAML 1.2
---
$id: http://devicetree.org/schemas/gpio/maxim,max77779-pmic.yaml#
$schema: http://devicetree.org/meta-schemas/core.yaml#

title: Maxim Integrated MAX77779 PMIC block (SGPIO)

maintainers:
  - W4HO <87742609+W4HO-ham@users.noreply.github.com>

description: |
  The MAX77779 interface PMIC is a set of I2C blocks on one chip: the
  charger (maxim,max77779-charger), the fuel gauge (maxim,max77779-fg), the
  Type-C port controller (maxim,max77779-tcpc) and the PMIC block, which
  owns the chip's interrupt line and eight SGPIO pins with interrupt
  support. This binding describes the PMIC block.

properties:
  compatible:
    const: maxim,max77779-pmic

  reg:
    maxItems: 1

  interrupts:
    maxItems: 1
    description: The chip's interrupt line (INTB), active low.

  "#gpio-cells":
    const: 2

  gpio-controller: true

  gpio-line-names:
    minItems: 1
    maxItems: 8

  "#interrupt-cells":
    const: 2

  interrupt-controller: true

required:
  - compatible
  - reg
  - "#gpio-cells"
  - gpio-controller

additionalProperties: false

examples:
  - |
    #include <dt-bindings/interrupt-controller/irq.h>

    i2c {
        #address-cells = <1>;
        #size-cells = <0>;

        pmic@66 {
            compatible = "maxim,max77779-pmic";
            reg = <0x66>;
            interrupt-parent = <&gpa8>;
            interrupts = <0 IRQ_TYPE_LEVEL_LOW>;
            gpio-controller;
            #gpio-cells = <2>;
            interrupt-controller;
            #interrupt-cells = <2>;
        };
    };
```

## Documentation/devicetree/bindings/input/cirrus,cs40l25a.yaml
```yaml
# SPDX-License-Identifier: (GPL-2.0-only OR BSD-2-Clause)
%YAML 1.2
---
$id: http://devicetree.org/schemas/input/cirrus,cs40l25a.yaml#
$schema: http://devicetree.org/meta-schemas/core.yaml#

title: Cirrus Logic CS40L25A boosted haptic driver

maintainers:
  - saiththerobo <the.tom.sharp@gmail.com>

description:
  The CS40L25A is a boosted class-D amplifier with a Halo Core DSP that
  drives a linear resonant actuator, controlled over I2C. It boots from
  ROM into a basic mode; the host loads its RAM firmware and plays
  effects through the firmware's mailbox.

properties:
  compatible:
    const: cirrus,cs40l25a

  reg:
    maxItems: 1

  interrupts:
    maxItems: 1

  reset-gpios:
    maxItems: 1
    description: The chip's active-low RESET line; asserted holds it in reset.

  cirrus,boost-peak-microamp:
    description: Peak current limit of the boost inductor.
    minimum: 1600000
    maximum: 4500000
    multipleOf: 50000
    default: 4500000

  cirrus,boost-ctl-microvolt:
    description: Maximum boost converter output voltage.
    minimum: 2550000
    maximum: 11000000
    multipleOf: 50000
    default: 11000000

required:
  - compatible
  - reg
  - reset-gpios

additionalProperties: false

examples:
  - |
    #include <dt-bindings/gpio/gpio.h>

    i2c {
        #address-cells = <1>;
        #size-cells = <0>;

        haptics@43 {
            compatible = "cirrus,cs40l25a";
            reg = <0x43>;
            reset-gpios = <&gpio 0 GPIO_ACTIVE_LOW>;
            cirrus,boost-peak-microamp = <4500000>;
            cirrus,boost-ctl-microvolt = <7500000>;
        };
    };
```
