## Documentation/devicetree/bindings/devfreq/google,gs201-mif.yaml
```yaml
# SPDX-License-Identifier: (GPL-2.0-only OR BSD-2-Clause)
%YAML 1.2
---
$id: http://devicetree.org/schemas/devfreq/google,gs201-mif.yaml#
$schema: http://devicetree.org/meta-schemas/core.yaml#

title: Google gs201 memory interface (MIF) frequency scaling

maintainers:
  - Ángel René <17342133+angelrenefm@users.noreply.github.com>

description:
  The memory interface (MIF) of the gs201 SoC, the DRAM controllers and
  their PHYs, is clocked by a DVFS domain of the ACPM firmware. Its rate is
  chosen from the activity of the bus masters that use most bandwidth, the
  CPU clusters and the GPU, among the operating points listed.

properties:
  compatible:
    const: google,gs201-mif

  clocks:
    minItems: 1
    items:
      - description: MIF DVFS domain clock
      - description: GPU shader clock

  clock-names:
    minItems: 1
    items:
      - const: mif
      - const: gpu

  operating-points-v2: true

  google,gpu:
    $ref: /schemas/types.yaml#/definitions/phandle
    description:
      The GPU node. The GPU only asks for MIF bandwidth while it is powered.

required:
  - compatible
  - clocks
  - clock-names
  - operating-points-v2

additionalProperties: false

examples:
  - |
    #include <dt-bindings/clock/google,gs201-acpm.h>

    memory-controller {
        compatible = "google,gs201-mif";
        clocks = <&acpm_ipc GS201_CLK_ACPM_DVFS_MIF>,
                 <&acpm_ipc GS201_CLK_ACPM_GPU>;
        clock-names = "mif", "gpu";
        operating-points-v2 = <&mif_opp_table>;
        google,gpu = <&gpu>;
    };
```

## Documentation/devicetree/bindings/display/panel/samsung,s6e3fc5.yaml
```yaml
# SPDX-License-Identifier: GPL-2.0-only OR BSD-2-Clause
%YAML 1.2
---
$id: http://devicetree.org/schemas/display/panel/samsung,s6e3fc5.yaml#
$schema: http://devicetree.org/meta-schemas/core.yaml#

title: Samsung S6E3FC5 AMOLED DSI panel

description:
  The S6E3FC5 is a display driver IC from Samsung Mobile Display, driving
  the 1080x2400 command-mode AMOLED panel of the Google Pixel 7a. The panel
  takes DSC-compressed pixel data over four MIPI DSI lanes and reports its
  refresh timing on a tearing effect (TE) line.

maintainers:
  - Derek Ross <derekross@gmail.com>
  - cx3301J <cx3301J@users.noreply.github.com>

allOf:
  - $ref: panel-common.yaml#

properties:
  compatible:
    const: samsung,s6e3fc5

  reg:
    maxItems: 1

  reset-gpios: true

  vci-supply:
    description: Analog supply

  vddi-supply:
    description: I/O supply

required:
  - compatible
  - reg
  - reset-gpios

unevaluatedProperties: false

examples:
  - |
    #include <dt-bindings/gpio/gpio.h>

    dsi {
        #address-cells = <1>;
        #size-cells = <0>;

        panel@0 {
            compatible = "samsung,s6e3fc5";
            reg = <0>;
            reset-gpios = <&gpa7 1 GPIO_ACTIVE_LOW>;
            vci-supply = <&panel_vci>;
            vddi-supply = <&panel_vddi>;
            width-mm = <64>;
            height-mm = <141>;
        };
    };

...
```

## Documentation/devicetree/bindings/firmware/omamobile,qseecom-compat.yaml
```yaml
# SPDX-License-Identifier: (GPL-2.0-only OR BSD-2-Clause)
%YAML 1.2
---
$id: http://devicetree.org/schemas/firmware/omamobile,qseecom-compat.yaml#
$schema: http://devicetree.org/meta-schemas/core.yaml#

title: Downstream-compatible QSEECOM userspace interface

maintainers:
  - johannSo <jzeug@soppa.de>

description:
  A /dev/qseecom with the downstream msm kernels' ioctl ABI, for vendor
  HALs that reach their trusted applications in QSEE through
  libQSEEComAPI. Buffers shared with QSEE are allocated from the SoC's
  qseecom carve-out.

properties:
  compatible:
    const: omamobile,qseecom-compat

  memory-region:
    maxItems: 1
    description: The no-map carve-out shared with QSEE.

required:
  - compatible
  - memory-region

additionalProperties: false

examples:
  - |
    qseecom {
        compatible = "omamobile,qseecom-compat";
        memory-region = <&qseecom_mem>;
    };
```

## Documentation/devicetree/bindings/gpio/maxim,max77779-sgpio.yaml
```yaml
# SPDX-License-Identifier: (GPL-2.0-only OR BSD-2-Clause)
%YAML 1.2
---
$id: http://devicetree.org/schemas/gpio/maxim,max77779-sgpio.yaml#
$schema: http://devicetree.org/meta-schemas/core.yaml#

title: Maxim Integrated MAX77779 SGPIO

maintainers:
  - W4HO <87742609+W4HO-ham@users.noreply.github.com>

description: |
  This module is part of the MAX77779 PMIC block. For additional
  information, see
  Documentation/devicetree/bindings/mfd/maxim,max77779-pmic.yaml.

  The SGPIO controller has eight lines with interrupt support. It
  interrupts through the SGPIO source of the PMIC block's interrupt
  controller and is the interrupt controller for its own lines: its
  interrupt cells number the lines, 0 to 7.

properties:
  compatible:
    const: maxim,max77779-sgpio

  "#gpio-cells":
    const: 2

  gpio-controller: true

  gpio-line-names:
    minItems: 1
    maxItems: 8

  "#interrupt-cells":
    const: 2

  interrupt-controller: true

required:
  - compatible
  - "#gpio-cells"
  - gpio-controller
  - "#interrupt-cells"
  - interrupt-controller

additionalProperties: false
```

## Documentation/devicetree/bindings/hwmon/samsung,s2mpg12-meter.yaml
```yaml
# SPDX-License-Identifier: GPL-2.0-only OR BSD-2-Clause
%YAML 1.2
---
$id: http://devicetree.org/schemas/hwmon/samsung,s2mpg12-meter.yaml#
$schema: http://devicetree.org/meta-schemas/core.yaml#

title: Samsung S2MPG12/S2MPG13 PMIC power meter

maintainers:
  - Derek Ross <derekross@gmail.com>

description: |
  The S2MPG12 and S2MPG13 PMICs, paired with Google's gs201 SoC, each have
  twelve power meter channels. A channel measures the power of one of the
  PMIC's own bucks or LDOs, or, through the VSEN_C pins, the power drawn
  through an external shunt resistor.

  This node is a child of the PMIC node, see
  Documentation/devicetree/bindings/mfd/samsung,s2mpg12-pmic.yaml and
  samsung,s2mpg13-pmic.yaml.

properties:
  compatible:
    enum:
      - samsung,s2mpg12-meter
      - samsung,s2mpg13-meter

  "#address-cells":
    const: 1

  "#size-cells":
    const: 0

patternProperties:
  "^channel@[0-9ab]$":
    type: object
    description: One meter channel.

    properties:
      reg:
        description: The meter channel.
        maximum: 11

      samsung,source:
        $ref: /schemas/types.yaml#/definitions/uint32
        description: |
          Input of the channel's multiplexer: 0x01-0x0a for BUCK1-BUCK10,
          on S2MPG13 also 0x0b (BUCKD), 0x0c (BUCKA), 0x0d (BUCKC) and
          0x10 (buck-boost); 0x20 + n for LDOn (n = 1-28); 0x5c-0x5e for
          the external shunts on VSEN_C1-VSEN_C3 (S2MPG12) or VSEN_C4-VSEN_C6
          (S2MPG13).
        enum: [0x01, 0x02, 0x03, 0x04, 0x05, 0x06, 0x07, 0x08, 0x09, 0x0a,
               0x0b, 0x0c, 0x0d, 0x10,
               0x21, 0x22, 0x23, 0x24, 0x25, 0x26, 0x27, 0x28, 0x29, 0x2a,
               0x2b, 0x2c, 0x2d, 0x2e, 0x2f, 0x30, 0x31, 0x32, 0x33, 0x34,
               0x35, 0x36, 0x37, 0x38, 0x39, 0x3a, 0x3b, 0x3c,
               0x5c, 0x5d, 0x5e]

      label:
        description: Name of the measured rail.

      shunt-resistor-micro-ohms:
        description:
          The shunt resistor of an external channel (samsung,source
          0x5c-0x5e). At least 1000.
        minimum: 1000

    required:
      - reg
      - samsung,source

    allOf:
      - if:
          properties:
            samsung,source:
              enum: [0x5c, 0x5d, 0x5e]
        then:
          required:
            - shunt-resistor-micro-ohms
        else:
          properties:
            shunt-resistor-micro-ohms: false

    additionalProperties: false

required:
  - compatible
  - "#address-cells"
  - "#size-cells"

additionalProperties: false

examples:
  - |
    power-meter {
        compatible = "samsung,s2mpg13-meter";
        #address-cells = <1>;
        #size-cells = <0>;

        channel@0 {
            reg = <0>;
            samsung,source = <0x5c>;
            label = "VSYS_PWR_DISPLAY";
            shunt-resistor-micro-ohms = <10000>;
        };

        channel@4 {
            reg = <4>;
            samsung,source = <0x02>;
            label = "S2S_VDD_G3D";
        };
    };
```

## Documentation/devicetree/bindings/input/touchscreen/novatek,nt36523-ts.yaml
```yaml
# SPDX-License-Identifier: GPL-2.0-only OR BSD-2-Clause
%YAML 1.2
---
$id: http://devicetree.org/schemas/input/touchscreen/novatek,nt36523-ts.yaml#
$schema: http://devicetree.org/meta-schemas/core.yaml#

title: Novatek NT36523 SPI touch controller

maintainers:
  - abhisheksreesaila <abhishek.sreesaila@gmail.com>

description:
  The touch half of the Novatek NT36523 touch and display driver chip, on
  SPI, as in the Google Pixel Tablet. The NT36523 and NT36523N revisions
  share this binding; the driver tells them apart by the chip id. The chip has no flash; the host loads
  its firmware after every reset. It reports up to ten touches. The display
  half is a separate device on the DSI bus, and the I2C Novatek
  controllers are covered by novatek,nvt-ts.yaml.

allOf:
  - $ref: /schemas/spi/spi-peripheral-props.yaml#
  - $ref: touchscreen.yaml#

properties:
  compatible:
    const: novatek,nt36523-ts

  reg:
    maxItems: 1

  interrupts:
    maxItems: 1

  reset-gpios:
    description: Touch reset (TP_RESX), active low
    maxItems: 1

  vio-supply:
    description:
      Digital I/O supply (1.8 V). The chip shares it with its display
      half, so a board whose display keeps it on may leave it out.

  firmware-name:
    maxItems: 1
    description:
      The firmware image to load. It is matched to the display panel the
      chip is bonded to.

  spi-max-frequency: true

required:
  - compatible
  - reg
  - interrupts
  - firmware-name

unevaluatedProperties: false

examples:
  - |
    #include <dt-bindings/gpio/gpio.h>
    #include <dt-bindings/interrupt-controller/irq.h>

    spi {
        #address-cells = <1>;
        #size-cells = <0>;

        touchscreen@0 {
            compatible = "novatek,nt36523-ts";
            reg = <0>;
            spi-max-frequency = <15000000>;
            interrupt-parent = <&gpa7>;
            interrupts = <0 IRQ_TYPE_EDGE_RISING>;
            reset-gpios = <&gpp23 2 GPIO_ACTIVE_LOW>;
            firmware-name = "novatek/nt36523n-tangorpro-boe.bin";
            touchscreen-size-x = <1600>;
            touchscreen-size-y = <2560>;
        };
    };
```

## Documentation/devicetree/bindings/mfd/maxim,max77779-pmic.yaml
```yaml
# SPDX-License-Identifier: (GPL-2.0-only OR BSD-2-Clause)
%YAML 1.2
---
$id: http://devicetree.org/schemas/mfd/maxim,max77779-pmic.yaml#
$schema: http://devicetree.org/meta-schemas/core.yaml#

title: Maxim Integrated MAX77779 PMIC block

maintainers:
  - W4HO <87742609+W4HO-ham@users.noreply.github.com>

description: |
  The MAX77779 interface PMIC is a set of I2C blocks on one chip: the
  charger (maxim,max77779-charger), the fuel gauge (maxim,max77779-fg), the
  Type-C port controller (maxim,max77779-tcpc), the battery voltage and
  current monitor, an I2C master and the PMIC block, which this binding
  describes.

  The PMIC block owns the chip's interrupt line (INTB) and is the interrupt
  controller for the chip's interrupt sources. The first cell of an
  interrupt specifier names the source:

    0: Type-C port controller
    1: fuel gauge
    2: charger
    3: I2C master
    4: battery voltage and current monitor (VIMON)
    5: SGPIO controller
    6: VDROOP
    7: PMIC top

  A block at its own address names its source here. The block also holds
  eight SGPIOs, described by the gpio child node, which interrupts through
  source 5 and is the interrupt controller for its own lines.

properties:
  compatible:
    const: maxim,max77779-pmic

  reg:
    maxItems: 1

  interrupts:
    maxItems: 1
    description: The chip's interrupt line (INTB), active low.

  interrupt-controller: true

  "#interrupt-cells":
    const: 2

  gpio:
    $ref: /schemas/gpio/maxim,max77779-sgpio.yaml

required:
  - compatible
  - reg

additionalProperties: false

examples:
  - |
    #include <dt-bindings/interrupt-controller/irq.h>

    i2c {
        #address-cells = <1>;
        #size-cells = <0>;

        pmic@66 {
            compatible = "maxim,max77779-pmic";
            reg = <0x66>;
            interrupts-extended = <&gpa8 0 IRQ_TYPE_LEVEL_LOW>;
            interrupt-controller;
            #interrupt-cells = <2>;

            gpio {
                compatible = "maxim,max77779-sgpio";
                gpio-controller;
                #gpio-cells = <2>;
                interrupt-controller;
                #interrupt-cells = <2>;
            };
        };
    };
```

## Documentation/devicetree/bindings/mfd/samsung,s2mpg12-pmic.yaml
```yaml
# SPDX-License-Identifier: GPL-2.0-only OR BSD-2-Clause
%YAML 1.2
---
$id: http://devicetree.org/schemas/mfd/samsung,s2mpg12-pmic.yaml#
$schema: http://devicetree.org/meta-schemas/core.yaml#

title: Samsung S2MPG12 Power Management IC

maintainers:
  - Derek Ross <derekross@gmail.com>

description: |
  The Samsung S2MPG12 is the main Power Management IC paired with Google's
  gs201 SoC, with buck converters, LDOs, power meters and a real-time clock.
  It is reached through the ACPM firmware.

  Unlike S2MPG10, it has no interrupt line of its own: it reports events
  in-band, and the SoC's VGPIO2AP system registers turn them into one level
  interrupt with a pending latch that the host acknowledges.

properties:
  compatible:
    const: samsung,s2mpg12-pmic

  interrupts:
    maxItems: 1

  google,vgpio2ap-sysreg:
    $ref: /schemas/types.yaml#/definitions/phandle
    description:
      Phandle to the VGPIO2AP system registers, which latch the PMIC's
      in-band interrupt.

  wakeup-source: true

  power-meter:
    type: object
    $ref: /schemas/hwmon/samsung,s2mpg12-meter.yaml
    description:
      The PMIC's power meter channels.

  regulators:
    type: object
    $ref: /schemas/regulator/samsung,s2mpg12-regulator.yaml
    description:
      LDO regulators. A rail with no child node has no constraints and
      is left as the bootloader set it.

required:
  - compatible
  - interrupts
  - google,vgpio2ap-sysreg

additionalProperties: false

examples:
  - |
    #include <dt-bindings/interrupt-controller/arm-gic.h>
    #include <dt-bindings/interrupt-controller/irq.h>

    pmic {
        compatible = "samsung,s2mpg12-pmic";
        interrupts = <GIC_SPI 72 IRQ_TYPE_LEVEL_HIGH>;
        google,vgpio2ap-sysreg = <&sysreg_vgpio2ap>;
        wakeup-source;
    };
```
