## drivers/firmware/qcom/Kconfig
```kconfig
# SPDX-License-Identifier: GPL-2.0-only
#
# For a description of the syntax of this configuration file,
# see Documentation/kbuild/kconfig-language.rst.
#

menu "Qualcomm firmware drivers"

config QCOM_PAS
	tristate "Qualcomm generic PAS interface driver"
	help
	  Enable the generic Peripheral Authentication Service (PAS) provided
	  by the firmware. It acts as the common layer with different TZ
	  backends plugged in whether it's an SCM implementation or a proper
	  TEE bus based PAS service implementation.

config QCOM_PAS_TEE
	tristate "Qualcomm PAS TEE interface driver"
	select QCOM_PAS
	depends on TEE
	depends on !CPU_BIG_ENDIAN
	default m if ARCH_QCOM
	help
	  Enable the generic Peripheral Authentication Service (PAS) provided
	  by the firmware TEE implementation as the backend.

config QCOM_SCM
	tristate "Qualcomm PAS SCM interface driver"
	select QCOM_PAS
	select QCOM_TZMEM
	default y if ARCH_QCOM

config QCOM_TZMEM
	tristate
	select GENERIC_ALLOCATOR

choice
	prompt "TrustZone interface memory allocator mode"
	depends on QCOM_TZMEM
	default QCOM_TZMEM_MODE_GENERIC
	help
	  Selects the mode of the memory allocator providing memory buffers of
	  suitable format for sharing with the TrustZone. If in doubt, select
	  'Generic'.

config QCOM_TZMEM_MODE_GENERIC
	bool "Generic"
	help
	  Use the generic allocator mode. The memory is page-aligned, non-cachable
	  and physically contiguous.

config QCOM_TZMEM_MODE_SHMBRIDGE
	bool "SHM Bridge"
	help
	  Use Qualcomm Shared Memory Bridge. The memory has the same alignment as
	  in the 'Generic' allocator but is also explicitly marked as an SHM Bridge
	  buffer.

	  With this selected, all buffers passed to the TrustZone must be allocated
	  using the TZMem allocator or else the TrustZone will refuse to use them.

endchoice

config QCOM_QSEECOM
	bool "Qualcomm QSEECOM interface driver"
	depends on QCOM_SCM=y
	select AUXILIARY_BUS
	help
	  Various Qualcomm SoCs have a Secure Execution Environment (SEE) running
	  in the Trust Zone. This module provides an interface to that via the
	  QSEECOM mechanism, using SCM calls.

	  The QSEECOM interface allows, among other things, access to applications
	  running in the SEE. An example of such an application is 'uefisecapp',
	  which is required to access UEFI variables on certain systems. If
	  selected, the interface will also attempt to detect and register client
	  devices for supported applications.

	  Select Y here to enable the QSEECOM interface driver.

config QCOM_QSEECOM_UEFISECAPP
	bool "Qualcomm SEE UEFI Secure App client driver"
	depends on QCOM_QSEECOM
	depends on EFI
	help
	  Various Qualcomm SoCs do not allow direct access to EFI variables.
	  Instead, these need to be accessed via the UEFI Secure Application
	  (uefisecapp), residing in the Secure Execution Environment (SEE).

	  This module provides a client driver for uefisecapp, installing efivar
	  operations to allow the kernel accessing EFI variables, and via that also
	  provide user-space with access to EFI variables via efivarfs.

	  Select Y here to provide access to EFI variables on the aforementioned
	  platforms.

config QCOM_QSEECOM_COMPAT
	tristate "Downstream-compatible /dev/qseecom for vendor HALs"
	depends on QCOM_QSEECOM
	depends on ARCH_QCOM || COMPILE_TEST
	depends on OF && DMA_SHARED_BUFFER
	select GENERIC_ALLOCATOR
	default n
	help
	  Provides /dev/qseecom with the subset of the downstream msm kernels'
	  ioctl ABI that a vendor HAL (run from its Android vendor image in a
	  chroot) and qseecomd use to load a trusted application, share
	  buffers with it, call it and serve its listener requests. Shared
	  buffers come from the SoC's qseecom carve-out as dma-bufs.

	  This is a compatibility layer for one vendor ABI, not upstreamable.
	  It is for vendor userspace on phones such as the OnePlus 7T Pro,
	  whose fingerprint HAL needs it, and stays off unless a board's own
	  kernel configuration enables it.

	  It opens a path from root to the secure world: root can load the
	  trusted applications the module's allowlists name, call them and
	  serve their listeners. Nothing loads or registers until the
	  allowlists name it.

	  If unsure, say N.

	  To compile this driver as a module, choose M here: the module will
	  be called qcom_qseecom_compat.

endmenu
```
