## Documentation/devicetree/bindings/mfd/samsung,s2mpg13-pmic.yaml
```yaml
# SPDX-License-Identifier: GPL-2.0-only OR BSD-2-Clause
%YAML 1.2
---
$id: http://devicetree.org/schemas/mfd/samsung,s2mpg13-pmic.yaml#
$schema: http://devicetree.org/meta-schemas/core.yaml#

title: Samsung S2MPG13 Power Management IC

maintainers:
  - Derek Ross <derekross@gmail.com>

description: |
  The Samsung S2MPG13 is the sub Power Management IC paired with Google's
  gs201 SoC, next to the S2MPG12 main PMIC. It has buck converters, 28 LDOs,
  power meters and NTC inputs, and is reached through the ACPM firmware.

  Its interrupt is a GPIO on the SoC. It is optional here: without it the
  regulators still work, and no PMIC event is reported.

properties:
  compatible:
    const: samsung,s2mpg13-pmic

  interrupts:
    maxItems: 1

  gpio:
    type: object
    description:
      The PMIC's eight general purpose pins. On the Pixel 7 boards they
      switch the camera supplies and wake the camera PMIC.

    properties:
      compatible:
        const: samsung,s2mpg13-gpio

      gpio-controller: true

      '#gpio-cells':
        const: 2

      gpio-line-names:
        maxItems: 8

    required:
      - compatible
      - gpio-controller
      - '#gpio-cells'

    additionalProperties: false

  power-meter:
    type: object
    $ref: /schemas/hwmon/samsung,s2mpg12-meter.yaml
    description:
      The PMIC's power meter channels.

  regulators:
    type: object
    $ref: /schemas/regulator/samsung,s2mpg13-regulator.yaml
    description:
      List of child nodes that specify the regulators.

  wakeup-source: true

required:
  - compatible
  - regulators

additionalProperties: false

examples:
  - |
    pmic {
        compatible = "samsung,s2mpg13-pmic";

        gpio {
            compatible = "samsung,s2mpg13-gpio";
            gpio-controller;
            #gpio-cells = <2>;
        };

        regulators {
            ldo9s {
                regulator-name = "vdd_gnss_core";
                regulator-min-microvolt = <725000>;
                regulator-max-microvolt = <1300000>;
            };
        };
    };
```

## Documentation/devicetree/bindings/power/supply/maxim,max77779-fg.yaml
```yaml
# SPDX-License-Identifier: (GPL-2.0-only OR BSD-2-Clause)
%YAML 1.2
---
$id: http://devicetree.org/schemas/power/supply/maxim,max77779-fg.yaml#
$schema: http://devicetree.org/meta-schemas/core.yaml#

title: Maxim MAX77779 fuel gauge

maintainers:
  - W4HO <87742609+W4HO-ham@users.noreply.github.com>

description:
  Fuel-gauge measurements from a MAX77779. The gauge keeps its battery model
  across reboots; after a power-on reset (Status bit 1) it starts from its
  defaults, and the operating system loads the model again. Charger control
  belongs to the charger.

allOf:
  - $ref: power-supply.yaml#

properties:
  compatible:
    const: maxim,max77779-fg

  reg:
    maxItems: 1

  shunt-resistor-micro-ohms:
    description: Resistance of the battery current sense resistor in micro-ohms.
    minimum: 100
    maximum: 100000

  maxim,fg-model:
    $ref: /schemas/types.yaml#/definitions/uint16-array
    minItems: 32
    maxItems: 32
    description:
      Cell characterization table of the gauge's ModelGauge m5 algorithm,
      from Maxim's battery modelling for the cell. Written to registers
      0x80-0x9f, followed by a model load, only after a power-on reset of
      the gauge.

  maxim,fg-params:
    $ref: /schemas/types.yaml#/definitions/uint16-array
    minItems: 22
    maxItems: 22
    description:
      Register values that go with maxim,fg-model, from the same battery
      model, in this fixed order (register address in parentheses; n marks
      a non-volatile shadow register, at the gauge's second I2C address)
        nNVCfg0 (0xc0), RelaxCfg (n, 0xb6), nLearnCfg (0x9f), Config (0x0c),
        Config2 (0xab), nFullSOCThr (0xbc), nFullCapRep (0xa9),
        nDesignCap (0xb3), dPAcc (0x46), nFullCapNom (0xa5), nVEmpty (0xc6),
        nQRTable00 (0xa0), nQRTable10 (0xa1), nQRTable20 (0xa2),
        nQRTable30 (0xa3), nRComp0 (0xa6), nTempCo (0xa7), nIChgTerm (0x9c),
        nMiscCfg (0xb2), nModelCfg (0x9e, not written), nThermCfg (0xca) and
        nFilterCfg (0x9d).

dependencies:
  maxim,fg-model: [ 'maxim,fg-params' ]
  maxim,fg-params: [ 'maxim,fg-model' ]

required:
  - compatible
  - reg
  - shunt-resistor-micro-ohms

unevaluatedProperties: false

examples:
  - |
    i2c {
        #address-cells = <1>;
        #size-cells = <0>;

        fuel-gauge@36 {
            compatible = "maxim,max77779-fg";
            reg = <0x36>;
            shunt-resistor-micro-ohms = <2000>;
        };
    };
```

## Documentation/devicetree/bindings/soc/google/google,gs201-aoc-sysmmu.yaml
```yaml
# SPDX-License-Identifier: (GPL-2.0-only OR BSD-2-Clause)
%YAML 1.2
---
$id: http://devicetree.org/schemas/soc/google/google,gs201-aoc-sysmmu.yaml#
$schema: http://devicetree.org/meta-schemas/core.yaml#

title: Google gs201 and zuma AoC System MMU

maintainers:
  - Derek Ross <derekross@gmail.com>

description:
  The Samsung System MMU in front of the AoC, the audio and sensor DSP,
  version 8 on gs201, version 9 on zuma (Tensor G3), whose register map
  differs. Only the AoC is behind it. It is programmed with the fixed
  translation windows the AoC firmware expects, by the AoC driver, while the
  AoC block is powered.

properties:
  compatible:
    enum:
      - google,gs201-aoc-sysmmu
      - google,zuma-aoc-sysmmu

  reg:
    maxItems: 1

  interrupts:
    description: the non-secure fault interrupt
    maxItems: 1

required:
  - compatible
  - reg
  - interrupts

additionalProperties: false

examples:
  - |
    #include <dt-bindings/interrupt-controller/arm-gic.h>
    sysmmu@1a090000 {
        compatible = "google,gs201-aoc-sysmmu";
        reg = <0x1a090000 0x10000>;
        interrupts = <GIC_SPI 118 IRQ_TYPE_LEVEL_HIGH>;
    };
```

## Documentation/devicetree/bindings/soc/google/google,gs201-bcl.yaml
```yaml
# SPDX-License-Identifier: (GPL-2.0-only OR BSD-2-Clause)
%YAML 1.2
---
$id: http://devicetree.org/schemas/soc/google/google,gs201-bcl.yaml#
$schema: http://devicetree.org/meta-schemas/core.yaml#

title: Google gs201 battery current limiter

maintainers:
  - Ángel René <17342133+angelrenefm@users.noreply.github.com>

description:
  On Google Tensor G2 (gs201) phones the charger PMIC (MAX77759) and the main
  PMIC (S2MPG12) raise lines when the battery voltage droops or its current
  goes over the limit. While a line is asserted the CPU clusters and the GPU
  are capped, so a load peak doesn't take the battery under the level where
  the phone shuts down.

properties:
  compatible:
    const: google,gs201-bcl

  smpl-warn-gpios:
    maxItems: 1
    description: The S2MPG12's SMPL_WARN, asserted when the battery falls
      under its warning voltage.

  vdroop1-gpios:
    maxItems: 1
    description: The MAX77759's SYS_UVLO1, the first system voltage level.

  vdroop2-gpios:
    maxItems: 1
    description: The MAX77759's SYS_UVLO2 or BAT_OILO, which share one pin,
      the second system voltage level or battery over-current.

  google,gpu:
    $ref: /schemas/types.yaml#/definitions/phandle
    description: The GPU, whose maximum frequency is capped with the CPUs'.

required:
  - compatible

anyOf:
  - required: [smpl-warn-gpios]
  - required: [vdroop1-gpios]
  - required: [vdroop2-gpios]

additionalProperties: false

examples:
  - |
    #include <dt-bindings/gpio/gpio.h>

    battery-current-limiter {
        compatible = "google,gs201-bcl";
        smpl-warn-gpios = <&gpa5 0 GPIO_ACTIVE_LOW>;
        vdroop1-gpios = <&gpa5 5 GPIO_ACTIVE_HIGH>;
        vdroop2-gpios = <&gpa5 6 GPIO_ACTIVE_HIGH>;
        google,gpu = <&gpu>;
    };
```

## Documentation/devicetree/bindings/soc/google/google,modemsmem.yaml
```yaml
# SPDX-License-Identifier: (GPL-2.0-only OR BSD-2-Clause)
%YAML 1.2
---
$id: http://devicetree.org/schemas/soc/google/google,modemsmem.yaml#
$schema: http://devicetree.org/meta-schemas/core.yaml#

title: Google modem SoC information in Qualcomm shared memory

maintainers:
  - Simon Schubert <simon@librem.one>

description:
  The modem firmware of the Google Pixel 3a and 3a XL (Qualcomm SDM670)
  reads a description of the SoC (the platform version, type and subtype)
  from an item in shared memory before its RF task starts. On these phones
  the bootloader does not provide it, and the operating system writes it
  from the SoC information it has.

properties:
  compatible:
    const: google,modemsmem

  qcom,smem:
    $ref: /schemas/types.yaml#/definitions/uint32
    description: The shared memory item the modem reads the SoC information from.

required:
  - compatible
  - qcom,smem

additionalProperties: false

examples:
  - |
    modemsmem {
        compatible = "google,modemsmem";
        qcom,smem = <134>;
    };
```

## Documentation/devicetree/bindings/sound/google,gs201-aoc-sound.yaml
```yaml
# SPDX-License-Identifier: (GPL-2.0-only OR BSD-2-Clause)
%YAML 1.2
---
$id: http://devicetree.org/schemas/sound/google,gs201-aoc-sound.yaml#
$schema: http://devicetree.org/meta-schemas/core.yaml#

title: Google Tensor AoC sound card

maintainers:
  - W4HO <87742609+W4HO-ham@users.noreply.github.com>

description:
  The sound card of the AoC, the audio and sensor DSP of Tensor SoCs. Its
  front ends are the AoC's entry points, and its back ends are the AoC's
  ports to the amplifiers, microphones, Bluetooth, USB and the modem. Every
  link runs on an AoC DAI, named by the AoC node and one cell from
  include/dt-bindings/sound/google,aoc.h. The driver derives the rest of a
  link from that cell, as Google's device trees set it.

allOf:
  - $ref: sound-card-common.yaml#

properties:
  compatible:
    enum:
      - google,gs201-aoc-sound
      - google,zumapro-aoc-sound

patternProperties:
  "^[a-z0-9-]+-dai-link$":
    type: object
    description: A DAI link, a front end or a back end by its AoC DAI.
    additionalProperties: false

    properties:
      link-name:
        $ref: /schemas/types.yaml#/definitions/string
        description:
          The link's stream name, which names its PCM device and which UCM
          profiles match.

      dai-format:
        description: The back end's format on the wire.
        enum: [i2s, dsp_a, dsp_b, left_j, right_j]

      bitclock-inversion:
        description: The back end's bit clock is inverted.
        type: boolean

      cpu:
        type: object
        description: The AoC DAI.
        additionalProperties: false
        properties:
          sound-dai:
            maxItems: 1
        required:
          - sound-dai

      codec:
        type: object
        description: The back end's codecs.
        additionalProperties: false
        properties:
          sound-dai:
            minItems: 1
            maxItems: 4
        required:
          - sound-dai

    required:
      - link-name
      - cpu

required:
  - compatible
  - model

unevaluatedProperties: false

examples:
  - |
    #include <dt-bindings/sound/google,aoc.h>

    sound {
        compatible = "google,zumapro-aoc-sound";
        model = "google,tegu-aoc-snd-card";

        fe-ep1-rx-dai-link {
            link-name = "EP1 playback";

            cpu {
                sound-dai = <&aoc AOC_PORT_EP1_PLAYBACK>;
            };
        };

        fe-ep1-tx-dai-link {
            link-name = "EP1 capture";

            cpu {
                sound-dai = <&aoc AOC_PORT_EP1_CAPTURE>;
            };
        };

        be-tdm0-rx-dai-link {
            link-name = "TDM_0_RX Playback";
            dai-format = "dsp_a";

            cpu {
                sound-dai = <&aoc AOC_PORT_TDM_0_RX>;
            };

            codec {
                sound-dai = <&amp_top>, <&amp_bottom>;
            };
        };
    };
```
