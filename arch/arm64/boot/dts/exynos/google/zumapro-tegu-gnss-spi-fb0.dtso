// SPDX-License-Identifier: GPL-2.0-only
/dts-v1/;
/plugin/;

/*
 * Pixel 9a bring-up, not for merge (MODEM-PLAN G3): the GNSS SPI with
 * stock's feedback delay 0 instead of the ported node's 2. Applied to
 * the palmtop's integration DTB (gn3), which has the spi21 label.
 */
&spi21 {
	gnss@0 {
		controller-data {
			samsung,spi-feedback-delay = <0>;
		};
	};
};
